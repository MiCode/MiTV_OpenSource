/dts-v1/;

/ {
	model = "Maxim";
	compatible = "arm,foundation-aarch64", "arm,maxim";
	interrupt-parent = <0x1>;
	#address-cells = <0x2>;
	#size-cells = <0x2>;

	chosen {
		bootargs = "console=ttyS0,115200 androidboot.console=ttyS0 root=/dev/ram rw rootwait init=/init CORE_DUMP_PATH=/data/core_dump.%%p.gz KDebug=1 delaylogo=true androidboot.selinux=permissive LX_MEM=0x3D500000 LX_MEM2=0xC0000000,0x1FF00000 EMAC_MEM=0x100000 PM51_ADDR=0x20010000 PM51_LEN=0x10000 CMA0=OTHERS,miu=0,hid=23,sz=0x7000000,st=0x11000000 CMA1=VDEC0,miu=0,hid=20,sz=0x3000000,st=0x18000000 CMA2=XC0,miu=0,hid=22,sz=0x6000000,st=0x1b000000 CMA3=OTHERS2,miu=1,hid=24,sz=0xec00000,st=0x0 CMA4=VDEC1,miu=1,hid=19,sz=0x7000000,st=0xec00000 CMA5=RETURN_ENUM,miu=1,hid=25,sz=0x2400000,st=0x15c00000 BOOTLOGO_IN_MBOOT ENV_VAR_OFFSET=0x0 ENV_VAR_SIZE=0x10000 ENV=EMMC SECURITY=ON";
	};

	cpus {
		#address-cells = <0x2>;
		#size-cells = <0x0>;

		cpu@0 {
			compatible = "arm,cortex-a53", "arm,armv8";
			reg = <0x0 0x0>;
			device_type = "cpu";
			enable-method = "mstar-spin-table";
			cpu-release-addr = <0x0 0x100510>;
			linux,phandle = <0x2>;
			phandle = <0x2>;
		};

		cpu@1 {
			compatible = "arm,cortex-a53", "arm,armv8";
			reg = <0x0 0x1>;
			device_type = "cpu";
			enable-method = "mstar-spin-table";
			cpu-release-addr = <0x0 0x100510>;
			linux,phandle = <0x3>;
			phandle = <0x3>;
		};

		cpu@2 {
			device_type = "cpu";
			compatible = "arm,armv8";
			reg = <0x0 0x2>;
			enable-method = "mstar-spin-table";
			cpu-release-addr = <0x0 0x100510>;
		};

		cpu@3 {
			device_type = "cpu";
			compatible = "arm,armv8";
			reg = <0x0 0x3>;
			enable-method = "mstar-spin-table";
			cpu-release-addr = <0x0 0x100510>;
		};
	};

	memory@20200000 {
		device_type = "memory";
		reg = <0x0 0x20200000 0x0 0x3d500000>;
	};

	memory@C0000000 {
		device_type = "memory";
		reg = <0x0 0xc0000000 0x0 0x1ff00000>;
	};

	interrupt-controller@16001000 {
		compatible = "arm,cortex-a15-gic", "arm,cortex-a9-gic";
		#interrupt-cells = <0x3>;
		#address-cells = <0x0>;
		interrupt-controller;
		reg = <0x0 0x16001000 0x0 0x1000 0x0 0x16002000 0x0 0x4000>;
		interrupts = <0x1 0x9 0xf04>;
		linux,phandle = <0x1>;
		phandle = <0x1>;
	};

	timer {
		compatible = "arm,armv8-timer";
		interrupts = <0x1 0xd 0xff01 0x1 0xe 0xff01 0x1 0xb 0xff01 0x1 0xa 0xff01>;
		clock-frequency = <0xb71b00>;
	};

	pmu {
		compatible = "arm,armv8-pmuv3";
		interrupts = <0x0 0x8a 0x4 0x0 0x8c 0x4 0x0 0x8e 0x4 0x0 0x8f 0x4>;
	};

	uart_0 {
		compatible = "mstar8250-uart";
		interrupts = <0x0 0x0 0x4>;
	};

	pm_sleep {
		compatible = "pm-sleep";
		interrupts = <0x0 0x1 0x4>;
	};

	Mstar-xhci-1 {
		compatible = "Mstar-xhci-1";
		interrupts = <0x0 0x2 0x0>;
	};

	mstar-mvd {
		compatible = "Mstar-mvd";
		interrupts = <0x0 0x3 0x0>;
	};

	mstar-ps {
		compatible = "Mstar-ps";
		interrupts = <0x0 0x4 0x0>;
	};

	fcie {
		compatible = "fcie";
		interrupts = <0x0 0x5 0x4>;
	};

	usbc_int0 {
		compatible = "usbc_int0";
		interrupts = <0x0 0x6 0x0>;
	};

	Mstar-ehci-1 {
		compatible = "Mstar-ehci-1";
		interrupts = <0x0 0x7 0x0>;
	};

	miic5 {
		compatible = "miic5";
		interrupts = <0x0 0x8 0x4>;
	};

	emac {
		compatible = "mstar-emac";
		interrupts = <0x0 0x9 0x4>;
	};

	xc {
		compatible = "mstar-xc";
		interrupts = <0x0 0xA 0x4>;
	};

	mspi {
		compatible = "mspi";
		interrupts = <0x0 0xB 0x4>;
	};

	miic3 {
		compatible = "miic3";
		interrupts = <0x0 0xC 0x4>;
	};

	evd {
		compatible = "evd";
		interrupts = <0x0 0xD 0x4>;
	};

	comb {
		compatible = "comb";
		interrupts = <0x0 0xE 0x4>;
	};

	ldm_dma_done_0 {
		compatible = "ldm_dma_done_0";
		interrupts = <0x0 0xF 0x4>;
	};

	mstar-tsp {
		compatible = "Mstar-tsp";
		interrupts = <0x0 0x10 0x0>;
	};

	ve {
		compatible = "ve";
		interrupts = <0x0 0x11 0x4>;
	};

	usbc_int3 {
		compatible = "usbc_int3";
		interrupts = <0x0 0x12 0x0>;
	};

	dc {
		compatible = "dc";
		interrupts = <0x0 0x13 0x4>;
	};

	mstar-gflip {
		compatible = "mstar-gflip";
		interrupts = <0x0 0x14 0x4>;
	};

	mstar-pcm {
		compatible = "Mstar-pcm";
		interrupts = <0x0 0x15 0x0>;
	};

	ldm_dma_done_1 {
		compatible = "ldm_dma_done_1";
		interrupts = <0x0 0x16 0x4>;
	};

	smart {
		compatible = "smart";
		interrupts = <0x0 0x17 0x4>;
	};

	uart_4 {
		compatible = "uart_4";
		interrupts = <0x0 0x18 0x4>;
	};

	mod_detect {
		compatible = "mod_detect";
		interrupts = <0x0 0x19 0x4>;
	};

	miic4 {
		compatible = "miic4";
		interrupts = <0x0 0x1A 0x4>;
	};

	scm {
		compatible = "scm";
		interrupts = <0x0 0x1B 0x4>;
	};

	mstar-vbi {
		compatible = "Mstar-vbi";
		interrupts = <0x0 0x1C 0x0>;
	};

	mvd2mips {
		compatible = "mvd2mips";
		interrupts = <0x0 0x1D 0x0>;
	};

	gpd {
		compatible = "gpd";
		interrupts = <0x0 0x1E 0x0>;
	};

	abcdvi2riu {
		compatible = "abcdvi2riu";
		interrupts = <0x0 0x1F 0x0>;
	};

	mstar-hvd {
		compatible = "Mstar-hvd";
		interrupts = <0x0 0x20 0x0>;
	};

	usbc_int1 {
		compatible = "usbc_int1";
		interrupts = <0x0 0x21 0x0>;
	};

	Mstar-ehci-2 {
		compatible = "Mstar-ehci-2";
		interrupts = <0x0 0x22 0x0>;
	};

	error_resp {
		compatible = "error_resp";
		interrupts = <0x0 0x23 0x0>;
	};

	usbc_int2 {
		compatible = "usbc_int2";
		interrupts = <0x0 0x24 0x0>;
	};

	Mstar-ehci-3 {
		compatible = "Mstar-ehci-3";
		interrupts = <0x0 0x25 0x0>;
	};

	miu_int {
		compatible = "miu_int";
		interrupts = <0x0 0x26 0x0>;
	};

	uart_1 {
		compatible = "uart_1";
		interrupts = <0x0 0x27 0x4>;
	};

	uart_2 {
		compatible = "uart_2";
		interrupts = <0x0 0x28 0x4>;
	};

	mspi_1 {
		compatible = "mspi_1";
		interrupts = <0x0 0x29 0x4>;
	};

	miu_security {
		compatible = "miu_security";
		interrupts = <0x0 0x2A 0x4>;
	};

	mstar-dipw {
		compatible = "Mstar-dipw";
		interrupts = <0x0 0x2B 0x0>;
	};

	miic2 {
		compatible = "miic2";
		interrupts = <0x0 0x2C 0x4>;
	};

	jpd {
		compatible = "jpd";
		interrupts = <0x0 0x2D 0x4>;
	};

	pm_irq_out {
		compatible = "pm_irq_out";
		interrupts = <0x0 0x2E 0x4>;
	};

	mfe {
		compatible = "mstar-mfe";
		interrupts = <0x0 0x2f 0x4>;
	};

	bdma_merge {
		compatible = "bdma_merge";
		interrupts = <0x0 0x30 0x4>;
	};

	uart_3 {
		compatible = "uart_3";
		interrupts = <0x0 0x31 0x4>;
	};

	uart2mcu {
		compatible = "uart2mcu";
		interrupts = <0x0 0x32 0x4>;
	};

	urdma2mcu {
		compatible = "urdma2mcu";
		interrupts = <0x0 0x33 0x4>;
	};

	hdmitx4vx1 {
		compatible = "mstar-hdmitx4vx1";
		interrupts = <0x0 0x34 0x0>;
	};

	irq-mali {
		compatible = "mstar-mali";
		interrupts = <0x0 0x35 0x4>;
	};

	irq_fiq2mips {
		compatible = "irq_fiq2mips";
		interrupts = <0x0 0x36 0x4>;
	};

	hdcp_icc {
		compatible = "hdcp_icc";
		interrupts = <0x0 0x37 0x4>;
	};

	hdcp_x74 {
		compatible = "hdcp_icc";
		interrupts = <0x0 0x38 0x4>;
	};

	mstar-aesdma-waddr-err {
		compatible = "Mstar-aesdma-waddr-err";
		interrupts = <0x0 0x39 0x0>;
	};

	dcsub {
		compatible = "dcsub";
		interrupts = <0x0 0x3A 0x4>;
	};

	sdio {
		compatible = "sdio";
		interrupts = <0x0 0x3B 0x4>;
	};

	cmdq {
		compatible = "cmdq";
		interrupts = <0x0 0x3C 0x4>;
	};

	miic1 {
		compatible = "miic1";
		interrupts = <0x0 0x3D 0x4>;
	};

	miic0 {
		compatible = "miic0";
		interrupts = <0x0 0x3F 0x4>;
	};

	timer0 {
		compatible = "timer0";
		interrupts = <0x0 0x40 0x4>;
	};

	timer1 {
		compatible = "timer1";
		interrupts = <0x0 0x41 0x4>;
	};

	wdt {
		compatible = "wdt";
		interrupts = <0x0 0x42 0x4>;
	};

	mbx {
		compatible = "mstar-mbx";
		interrupts = <0x0 0x44 0x4 0x0 0x45 0x4 0x0 0x46 0x4 0x0 0x47 0x4 0x0 0xC0 0x4 0x0 0xC1 0x4>;
	};

    hdmi_nonpcm {
        compatible = "hdmi_nonpcm";
        interrupts = <0x0 0x4b 0x4>;
    };

    spdif_in_nonpcm {
        compatible = "spdif_in_nonpcm";
        interrupts = <0x0 0x4c 0x4>;
    };

    lan_esd {
        compatible = "spdif_in_nonpcm";
        interrupts = <0x0 0x4d 0x4>;
    };

	mstar-dsp-up {
		compatible = "Mstar-dsp-up";
		interrupts = <0x0 0x4E 0x0>;
	};

    tsp2aeon {
        compatible = "tsp2aeon";
        interrupts = <0x0 0x4f 0x4>;
    };

    vivaldi_str {
        compatible = "vivaldi_str";
        interrupts = <0x0 0x50 0x4>;
    };

    vivaldi_pts {
        compatible = "vivaldi_pts";
        interrupts = <0x0 0x51 0x4>;
    };

    dsp_miu_prot {
        compatible = "dsp_miu_prot";
        interrupts = <0x0 0x52 0x4>;
    };

	mstar-xiu-timeout {
		compatible = "Mstar-xiu-timeout";
		interrupts = <0x0 0x53 0x0>;
	};

    dmdmcu2hk {
        compatible = "dmdmcu2hk";
        interrupts = <0x0 0x54 0x4>;
    };

	ve_vbi_f0 {
		compatible = "ve_vbi_f0";
		interrupts = <0x0 0x55 0x0>;
	};

	ve_vbi_f1 {
		compatible = "ve_vbi_f0";
		interrupts = <0x0 0x56 0x0>;
	};

	vdmcu2hk {
		compatible = "vdmcu2hk";
		interrupts = <0x0 0x57 0x0>;
	};

	ve_done_TT {
		compatible = "ve_done_TT";
		interrupts = <0x0 0x58 0x0>;
	};

	PM_SD_CDZ {
		compatible = "PM_SD_CDZ";
		interrupts = <0x0 0x5A 0x0>;
	};

	CFEC_VSYNC {
		compatible = "AFEC_VSYNC";
		interrupts = <0x0 0x5C 0x0>;
	};

	tso {
		compatible = "tso";
		interrupts = <0x0 0x5E 0x0>;
	};

	dsp2mips {
		compatible = "dsp2mips";
		interrupts = <0x0 0x5F 0x0>;
	};

	AU_DMA_BUFFER_INT_EDGE {
		compatible = "AU_DMA_BUFFER_INT_EDGE";
		interrupts = <0x0 0x61 0x0>;
	};

	ir {
		compatible = "mstar-ir";
		interrupts = <0x0 0x62 0x4>;
	};

	PM_SD_CDZ_1 {
		compatible = "PM_SD_CDZ_1";
		interrupts = <0x0 0x63 0x0>;
	};

	host0_int {
		compatible = "host0_int";
		interrupts = <0x0 0x64 0x4  0x0 0x65 0x4  0x0 0x66 0x4>;
	};

	ext_gpio_0 {
		compatible = "ext_gpio_0";
		interrupts = <0x0 0x67 0x0>;
	};

	host1_int {
		compatible = "host1_int";
		interrupts = <0x0 0x68 0x4  0x0 0x6a 0x4>;
	};

	ext_gpio_1 {
		compatible = "ext_gpio_1";
		interrupts = <0x0 0x6B 0x0>;
	};

	host2_int {
		compatible = "host2_int";
		interrupts = <0x0 0x6C 0x4  0x0 0x6E 0x4>;
	};

	timer2 {
		compatible = "timer2";
		interrupts = <0x0 0x6D 0x0>;
	};

	ext_gpio_2 {
		compatible = "ext_gpio_2";
		interrupts = <0x0 0x6F 0x0>;
	};

	host3_int {
		compatible = "host3_int";
		interrupts = <0x0 0x70 0x4  0x0 0x71 0x4  0x0 0x72 0x4>;
	};

	fiqxiu_timeout {
		compatible = "fiqxiu_timeout";
		interrupts = <0x0 0x73 0x4>;
	};

	ext_gpio_3 {
		compatible = "ext_gpio_3";
		interrupts = <0x0 0x77 0x0>;
	};

	ext_gpio_4 {
		compatible = "ext_gpio_4";
		interrupts = <0x0 0x78 0x0>;
	};

	ext_gpio_5 {
		compatible = "ext_gpio_5";
		interrupts = <0x0 0x79 0x0>;
	};

	ext_gpio_6 {
		compatible = "ext_gpio_6";
		interrupts = <0x0 0x7A 0x0>;
	};

	pwm_rp_l {
		compatible = "pwm_rp_l";
		interrupts = <0x0 0x7B 0x0>;
	};

	pwm_fp_l {
		compatible = "pwm_fp_l";
		interrupts = <0x0 0x7C 0x0>;
	};

	pwm_rp_r {
		compatible = "pwm_rp_r";
		interrupts = <0x0 0x7D 0x0>;
	};

	pwm_fp_r {
		compatible = "pwm_fp_r";
		interrupts = <0x0 0x7E 0x0>;
	};

	ext_gpio_7 {
		compatible = "ext_gpio_7";
		interrupts = <0x0 0x7F 0x0>;
	};

	HDMITX_IRQ_LEVEL {
		compatible = "HDMITX_IRQ_LEVEL";
		interrupts = <0x0 0xA0 0x0>;
	};

	vd_evd_r22hi {
		compatible = "vd_evd_r22hi";
		interrupts = <0x0 0xA1 0x0>;
	};

	Mstar-ehci-4 {
		compatible = "Mstar-ehci-4";
		interrupts = <0x0 0xA2 0x0>;
	};

	ge {
		compatible = "ge";
		interrupts = <0x0 0xA3 0x0>;
	};

	mstar-cec-int-pm {
		compatible = "Mstar-cec-int-pm";
		interrupts = <0x0 0xA4 0x0>;
	};

	disp_fe {
		compatible = "disp_fe";
		interrupts = <0x0 0xA5 0x0>;
	};

	scdc_int_pm {
		compatible = "scdc_int_pm";
		interrupts = <0x0 0xA6 0x0>;
	};

	usb30_hs_usb {
		compatible = "usb30_hs_usb";
		interrupts = <0x0 0xA9 0x0>;
	};

	Mstar-ehci-5 {
		compatible = "Mstar-ehci-5";
		interrupts = <0x0 0xAA 0x0>;
	};

	hdmitx_phy {
		compatible = "hdmitx_phy";
		interrupts = <0x0 0xAB 0x0>;
	};

	kg1 {
		compatible = "kg1";
		interrupts = <0x0 0xAC 0x0>;
	};

	tsp_fi_queue {
		compatible = "tsp_fi_queue";
		interrupts = <0x0 0xAD 0x0>;
	};

	disp_sc2 {
		compatible = "disp_sc2";
		interrupts = <0x0 0xAE 0x0>;
	};

	mspi_mcard {
		compatible = "mspi_mcard";
		interrupts = <0x0 0xAF 0x0>;
	};

	d2b {
		compatible = "d2b";
		interrupts = <0x0 0xB0 0x0>;
	};

	AUDMA_V2_INTR {
		compatible = "AUDMA_V2_INTR";
		interrupts = <0x0 0xB1 0x0>;
	};

	emmc_osp {
		compatible = "emmc_osp";
		interrupts = <0x0 0xB2 0x0>;
	};

	mhl_ecbus {
		compatible = "mhl_ecbus";
		interrupts = <0x0 0xB3 0x0>;
	};

	pka_all {
		compatible = "pka_all";
		interrupts = <0x0 0xB4 0x0>;
	};

	cfktks_int_nonsec {
		compatible = "cfktks_int_nonsec";
		interrupts = <0x0 0xB5 0x0>;
	};

	cfktks_int {
		compatible = "cfktks_int";
		interrupts = <0x0 0xB6 0x0>;
	};

	cfdone {
		compatible = "cfdone";
		interrupts = <0x0 0xB7 0x0>;
	};

	rxiu_timeout_nodefine {
		compatible = "rxiu_timeout_nodefine";
		interrupts = <0x0 0xB8 0x0>;
	};

	PAS_PTS_INTRL_COMBINE {
		compatible = "PAS_PTS_INTRL_COMBINE";
		interrupts = <0x0 0xB9 0x0>;
	};

	aesdma_s {
		compatible = "aesdma_s";
		interrupts = <0x0 0xBA 0x0>;
	};

	mspi_0 {
		compatible = "mspi_0";
		interrupts = <0x0 0xBB 0x0>;
	};

	cert_ktks_int_nonsec {
		compatible = "cert_ktks_int_nonsec";
		interrupts = <0x0 0xBC 0x0>;
	};

	cert_ktks_int {
		compatible = "cert_ktks_int";
		interrupts = <0x0 0xBD 0x0>;
	};

	aesdma2_s {
		compatible = "aesdma2_s";
		interrupts = <0x0 0xBE 0x0>;
	};

	aesdma2 {
		compatible = "aesdma2";
		interrupts = <0x0 0xBF 0x0>;
	};

	AU_SPDIF_TX_CS_0 {
		compatible = "AU_SPDIF_TX_CS_0";
		interrupts = <0x0 0xC2 0x0>;
	};

	AU_SPDIF_TX_CS_1 {
		compatible = "AU_SPDIF_TX_CS_1";
		interrupts = <0x0 0xC3 0x0>;
	};

	mstar-ldm-dma-done-0 {
		compatible = "mstar-ldm-dma-done-0";
		interrupts = <0x0 0xC4 0x0>;
	};

	mstar-ldm-dma-done-1 {
		compatible = "mstar-ldm-dma-done-1";
		interrupts = <0x0 0xC5 0x0>;
	};

	ir_in {
		compatible = "ir_in";
		interrupts = <0x0 0xC6 0x0>;
	};

	fo {
		compatible = "fo";
		interrupts = <0x0 0xCF 0x0>;
	};

	HDMITX_IRQ_EDGE {
		compatible = "HDMITX_IRQ_EDGE";
		interrupts = <0x0 0xD2 0x0>;
	};

	emac_man {
		compatible = "emac_man";
		interrupts = <0x0 0xD3 0x0>;
	};


	scaler {
		compatible = "mstar-scaler";
	};

	gflip {
		compatible = "mstar-gflip";
	};

	alsa {
		compatible = "Mstar-alsa";
	};

	rtc {
		compatible = "mstar-rtc";
	};

	Mstar-utopia2k-str {
		compatible = "Mstar-utopia2k-str";

		mhl {

			resume {

				stage0 {
					pre-condition = "hdmi_rx";
				};
			};
		};

		hdmi_rx {

			resume {

				stage0 {
					post-condition = "hdmi_rx";
				};
			};
		};

		avd {

			resume {

				stage0 {
					pre-condition = "vif";
				};
			};
		};

		vif {

			resume {

				stage0 {
					post-condition = "vif";
				};
			};
		};

        miu {
          resume {
            stage0 {
              post-condition = "miu";
            };
          };
        };
	};

	mstar-pm {
		compatible = "mstar-pm";
	};

	firmware {

		android {
			compatible = "android,firmware";
			hardware = "maxim";
			revision = "1234";
			Serial = "0000000000000000";
			Processor = "AArch64 Processor rev 3 (aarch64)";
			serialno = "123456789";
			mode = "123456789";
			baseband = "123456789";
			bootloader = "123456789";
			fstab {
				compatible = "android,fstab";
				system {
					compatible = "android,system";
					dev = "/dev/block/platform/mstar_mci.0/by-name/system";
					type = "ext4";
					mnt_flags = "ro";
					fsmgr_flags = "wait";
				};
				vendor {
					compatible = "android,system";
					dev = "/dev/block/platform/mstar_mci.0/by-name/vendor";
					type = "ext4";
					mnt_flags = "ro";
					fsmgr_flags = "wait";
				};
			};
		};
	};

	gpio {
		compatible = "mstar,gpio";
		gpio-controller;
		#gpio-cells = <0x1>;
		interrupt-controller;
		#interrupt-cells = <0x2>;
	};

	switch_gpio {
		compatible = "mstar,switch-gpio";
		switch-name = "h2w";
		switch-gpio = <999>;
		switch-inverse = <0>;
	};

	i2c0: i2c@0 {
		compatible = "mstar,swi2c";
		bus-index = <0x0>;
		sda-gpio = <0x39>;
		scl-gpio = <0x38>;
		speed-khz = <0x64>;
		def-delay = <0x64>;
		retries = <5>;
		status = "okay";
		iic-mode = <1>;
		hw-port = <3>;
		pad-mux = <25>;
	};

	i2c@1 {
		compatible = "mstar,swi2c";
		bus-index = <0x1>;
		sda-gpio = <0x9a>;
		scl-gpio = <0x99>;
		speed-khz = <0x64>;
		def-delay = <0x64>;
		retries = <0x5>;
		status = "okay";
		iic-mode = <0>;
		hw-port = <0>;
		pad-mux = <0>;
	};

	i2c@2 {
		compatible = "mstar,swi2c";
		bus-index = <0x2>;
		sda-gpio = <0x4e>;
		scl-gpio = <0x4d>;
		speed-khz = <0x64>;
		def-delay = <0x64>;
		retries = <0x5>;
		status = "okay";
		iic-mode = <0>;
		hw-port = <0>;
		pad-mux = <0>;
	};
};
