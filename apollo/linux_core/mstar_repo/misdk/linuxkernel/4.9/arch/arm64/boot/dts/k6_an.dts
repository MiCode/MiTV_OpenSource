#include <dt-bindings/thermal/thermal.h>
/dts-v1/;

/ {
	model = "k6";
	compatible = "arm,foundation-arm", "arm,k6";
	interrupt-parent = <0x1>;
	#address-cells = <0x2>;
	#size-cells = <0x2>;

	chosen {
		bootargs = "root=/dev/mmcblk0p4 rootfstype=ext4 rw rootwait init=/sbin/init ip=dhcp console=ttyS0,115200,LX_MEM=0x02000000";
	};

	cpus {
		#address-cells = <0x2>;
		#size-cells = <0x0>;
                cpu-map {
                        cluster0: cluster0 {
                                #cooling-cells = <0x2>;
                                core0 {
                                        cpu = <&cpu0>;
                                };
                                core1 {
                                        cpu = <&cpu1>;
                                };
                        };
                };
		cpu0: cpu@0 {
			compatible = "arm,cortex-a53", "arm,armv8";
			reg = <0x0 0x0>;
			device_type = "cpu";
			enable-method = "mstar-spin-table";
			cpu-release-addr = <0x0 0x100510>;
			linux,phandle = <0x2>;
			phandle = <0x2>;
		};

		cpu1: cpu@1 {
			compatible = "arm,cortex-a53", "arm,armv8";
			reg = <0x0 0x1>;
			device_type = "cpu";
			enable-method = "mstar-spin-table";
			cpu-release-addr = <0x0 0x100510>;
			linux,phandle = <0x3>;
			phandle = <0x3>;
		};

	};

	memory@20200000 {
		device_type = "memory";
		reg = <0x0 0x20200000 0x0 0x1f400000>;
	};

	memory@38C00000 {
		device_type = "memory";
		reg = <0x0 0x4dc00000 0x0 0x8a00000>;
	};

	memory@A0000000 {
		device_type = "memory";
		reg = <0x0 0xb2a00000 0x0 0x2d600000>;
	};

	interrupt-controller@16001000 {
		compatible = "arm,cortex-a15-gic", "arm,cortex-a9-gic";
		#interrupt-cells = <0x3>;
		#address-cells = <0x0>;
		interrupt-controller;
		reg = <0x0 0x16001000 0x0 0x1000 0x0 0x16002000 0x0 0x4000>;
		interrupts = <0x1 0x9 0xf04>;
		linux,phandle = <0x1>;
		phandle = <0x1>;
	};

	timer {
		compatible = "arm,armv8-timer";
		interrupts = <0x1 0xd 0xff01 0x1 0xe 0xff01 0x1 0xb 0xff01 0x1 0xa 0xff01>;
		clock-frequency = <0xb71b00>;
	};

	pmu {
		compatible = "arm,armv8-pmuv3";
		interrupts = <0x0 0x3c 0x4 0x0 0x3d 0x4 0x0 0x3e 0x4 0x0 0x3f 0x4>;
	};

	uart0 {
		compatible = "mstar8250-uart";
		interrupts = <0x0 0x0 0x4>;
	};

	miic1 {
		compatible = "miic1";
		interrupts = <0x0 0x1 0x4>;
	};

	mvd2mips {
		compatible = "mvd2mips";
		interrupts = <0x0 0x2 0x4>;
	};


	mstar-mvd {
		compatible = "Mstar-mvd";
		interrupts = <0x0 0x3 0x4>;
	};

	reg_top_gpio2 {
		compatible = "reg_top_gpio2";
		interrupts = <0x0 0x4 0x4>;
	};

	ca_nsk {
		compatible = "reg_top_gpio2";
		interrupts = <0x0 0x5 0x4>;
	};

	Mstar-usb {
		compatible = "Mstar-usb";
		interrupts = <0x0 0x6 0x4>;
	};
         

	Mstar-ehci-1 {
		compatible = "Mstar-ehci-1";
		interrupts = <0x0 0x7 0x4>;
	};

	sata_phy_irq {
		compatible = "sata_phy_irq";
		interrupts = <0x0 0x8 0x4>;
	};

	emac{
		compatible = "mstar-emac";
		interrupts = <0x0 0xBE 0x4>;
	};

	gmac{
		compatible = "mstar-gmac";
		interrupts = <0x0 0x9 0x4>;
	};

	scaler {
		compatible = "mstar-scaler";
		interrupts = <0x0 0xa 0x4>;
	};

	tsio {
		compatible = "tsio";
		interrupts = <0x0 0xb 0x4>;
	};

	mspi   {
		compatible = "mspi";
		interrupts = <0x0 0xc 0x4>;
	};

	evd   {
		compatible = "evd";
		interrupts = <0x0 0xd 0x4>;
	};

	SATA_PHY {
		compatible = "SATA_PHY";
		interrupts = <0x0 0xe 0x4>;
	};
	sata_intrq {
		compatible = "sata_intrq";
		interrupts = <0x0 0xf 0x4>;
	};


	mstar-tsp {
		compatible = "Mstar-tsp";
		interrupts = <0x0 0x10 0x4>;
	};

	ve {
		compatible = "ve";
		interrupts = <0x0 0x11 0x4>;
	};

	aeon2hi {
		compatible = "aeon2hi";
		interrupts = <0x0 0x12 0x4>;
	};

	dc {
		compatible = "dc";
		interrupts = <0x0 0x13 0x4>;
	};


	gflip {
		compatible = "mstar-gflip";
		interrupts = <0x0 0x14 0x4>;
	};

	imi_top {
		compatible = "imi_top";
		interrupts = <0x0 0x15 0x4>;
	};

	miic0 {
		compatible = "miic0";
		interrupts = <0x0 0x16 0x4>;
	};

	rtc0 {
		compatible = "rtc0";
		interrupts = <0x0 0x17 0x4>;
	};

	keypad{
		compatible = "keypad";
		interrupts = <0x0 0x18 0x4>;
	};

	pm {
		compatible = "keypad";
		interrupts = <0x0 0x19 0x4>;
	};

	mfe {
		compatible = "mfe";
		interrupts = <0x0 0x1a 0x4>;
	};

	EMM_ECM {
		compatible = "EMM_ECM";
		interrupts = <0x0 0x1b 0x4>;
	};

	UART_CA {
		compatible = "UART_CA";
		interrupts = <0x0 0x1c 0x4>;
	};

	rtc1 {
		compatible = "keypad";
		interrupts = <0x0 0x1d 0x4>;
	};

	CA_IP {
		compatible = "CA_IP";
		interrupts = <0x0 0x1e 0x4>;
	};

	ADCDVI2RIU {
		compatible = "ADCDVI2RIU";
		interrupts = <0x0 0x1f 0x4>;
	};

	TSP_TSO0 {
		compatible = "TSP_TSO0";
		interrupts = <0x0 0x20 0x4>;
	};

	usb1 {
		compatible = "usb1";
		interrupts = <0x0 0x21 0x4>;
	};
 
	Mstar-ehci-2 {
		compatible = "Mstar-ehci-2";
		interrupts = <0x0 0x22 0x0>;
	};

  Mstar-udc {
    compatible = "Mstar-udc";
    interrupts = <0x0 0x25 0x0>;
  };

  Mstar-otg {
    compatible = "Mstar-otg";
    interrupts = <0x0 0x06 0x0>, <0x0 0x07 0x0>;
   };

	miu {
		compatible = "miu";
		interrupts = <0x0 0x23 0x4>;
	};

	error_res {
		compatible = "error_res";
		interrupts = <0x0 0x24 0x4>;
	};

	otg {
		compatible = "otg";
		interrupts = <0x0 0x25 0x4>;
	};

	U3_PCIE_PHY {
		compatible = "U3_PCIE_PHY";
		interrupts = <0x0 0x26 0x4>;
	};

	uart1 {
		compatible = "uart1";
		interrupts = <0x0 0x27 0x4>;
	};

	HVD {
		compatible = "HVD";
		interrupts = <0x0 0x28 0x4>;
	};

	gpio4_irq {
		compatible = "gpio4_irq";
		interrupts = <0x0 0x29 0x4>;
	};

	_gpio4_irq {
		compatible = "_gpio4_irq";
		interrupts = <0x0 0x2A 0x4>;
	};
 
	emmc_osp {
		compatible = "emmc_osp";
		interrupts = <0x0 0x2B 0x4>;
	};

	ca_crypto_dma {
		compatible = "ca_crypto_dma";
		interrupts = <0x0 0x2C 0x4>;
	};

	jpd {
		compatible = "jpd";
		interrupts = <0x0 0x2D 0x4>;
	};

	disp1 {
		compatible = "disp1";
		interrupts = <0x0 0x2E 0x4>;
	};
 
 	AKL {
		compatible = "AKL";
		interrupts = <0x0 0x2F 0x4>;
	};

	bdma0 {
		compatible = "Mstar-dipw";
		interrupts = <0x0 0x30 0x4>;
	};

	bdma1 {
		compatible = "bdma1";
		interrupts = <0x0 0x31 0x4>;
	};

	uart2mcu {
		compatible = "uart2mcu";
		interrupts = <0x0 0x32 0x4>;
	};

	uartdma2mcu {
		compatible = "uartdma2mcu";
		interrupts = <0x0 0x33 0x4>;
	};

	DVI_HDMI_HDCP {
		compatible = "DVI_HDMI_HDCP";
		interrupts = <0x0 0x34 0x4>;
	};


	cec{
		compatible = "cec";
		interrupts = <0x0 0x35 0x4>;
	};

	hdmi_tx_irq{
		compatible = "hdmi_tx_irq";
		interrupts = <0x0 0x36 0x4>;
	};


	fcie {
		compatible = "fcie";
		interrupts = <0x0 0x37 0x4>;
	};

	hdcp_x74 {
		compatible = "hdcp_x74 ";
		interrupts = <0x0 0x38 0x4>;
	};

	GPD {
		compatible = "GPD ";
		interrupts = <0x0 0x39 0x4>;
	};

	sar1 {
		compatible = "sar1";
		interrupts = <0x0 0x3a 0x4>;
	};

	dac_plug_det{
		compatible = "dac_plug_det";
		interrupts = <0x0 0x3b 0x4>;
	};

	rtop_gpio2 {
		compatible = "rtop_gpio2 ";
		interrupts = <0x0 0x3c 0x4>;
	};

	RASP0 {
		compatible = "RASP0";
		interrupts = <0x0 0x3d 0x4>;
	};

	fi_queue {
		compatible = "fi_queue";
		interrupts = <0x0 0x3e 0x4>;
	};

	frm_pm_irq {
		compatible = "frm_pm_irq";
		interrupts = <0x0 0x3f 0x4>;
	};

	timer0{
		compatible = "timer0";
		interrupts = <0x0 0x40 0x4>;
	};

	timer1{
		compatible = "timer1";
		interrupts = <0x0 0x41 0x4>;
	};

	wdt {
		compatible = "wdt";
		interrupts = <0x0 0x42 0x4>;
	};

	mbx {
		compatible = "mstar-mbx";
		interrupts = <0x0 0x45 0x4 0x0 0x46 0x4  0x0 0x47 0x4  0x0 0x48 0x4 0x0 0x4a 0x4>;
	};

	FIQ_UART {
		compatible = "FIQ_UART";
		interrupts = <0x0 0x4b 0x4>;
	};

	MB_AUR2TO_MCU2 {
		compatible = "MB_AUR2TO_MCU2";
		interrupts = <0x0 0x4c 0x4>;
	};

	hdmi_nonpcm {
		compatible = "hdmi_nonpcm";
		interrupts = <0x0 0x4b 0x4>;
	};

	spdif_in_nonpcm {
		compatible = "spdif_in_nonpcm";
		interrupts = <0x0 0x4c 0x4>;
	};

	lan_esd {
		compatible = "spdif_in_nonpcm";
		interrupts = <0x0 0x4d 0x4>;
	};

	se_dsp2up {
		compatible = "se_dsp2up";
		interrupts = <0x0 0x4e 0x4>;
	};

	tsp2aeon {
		compatible = "tsp2aeon";
		interrupts = <0x0 0x4f 0x4>;
	};

	vivaldi_str {
		compatible = "vivaldi_str";
		interrupts = <0x0 0x50 0x4>;
	};

	vivaldi_pts {
		compatible = "vivaldi_pts";
		interrupts = <0x0 0x51 0x4>;
	};

	dsp_miu_prot {
		compatible = "dsp_miu_prot";
		interrupts = <0x0 0x52 0x4>;
	};

	mstar-xiu-timeout {
		compatible = "Mstar-xiu-timeout";
		interrupts = <0x0 0x53 0x0>;
	};

        dmdcp {
		compatible = "dmdcp";
		interrupts = <0x0 0x54 0x0>;
        };

        ve_vbi_f0 {
		compatible = "ve_vbi_f0";
		interrupts = <0x0 0x55 0x0>;

        };

        ve_vbi_f1 {
		compatible = "ve_vbi_f0";
		interrupts = <0x0 0x56 0x0>;

        };

        aur2to_mcu3 {
		compatible = "aur2to_mcu3";
		interrupts = <0x0 0x57 0x0>;

        };

        ve_done_tt {
		compatible = "ve_done_tt";
		interrupts = <0x0 0x58 0x0>;

        };
        CCFL {
		compatible = "CCFL";
		interrupts = <0x0 0x59 0x0>;
         };

        FIQ_IN {
		compatible = "FIQ_IN";
		interrupts = <0x0 0x5a 0x0>;
         };
	ir {
		compatible = "mstar-ir";
		interrupts = <0x0 0x5b 0x4>;
	};


	au_spdif_tx_cs0 {
		compatible = "au_spdif_tx_cs0";
		interrupts = <0x0 0x5c 0x4>;
	};

	au_spdif_tx_cs1 {
		compatible = "au_spdif_tx_cs1";
		interrupts = <0x0 0x5e 0x4>;
	};

	dsp2mips {
		compatible = "dsp2mips";
		interrupts = <0x0 0x5f 0x4>;
	};

	ir_rc {
		compatible = "ir_rc";
		interrupts = <0x0 0x60 0x4>;
	};

	au_dma_buffer {
		compatible = "au_dma_buffer";
		interrupts = <0x0 0x61 0x4>;
	};

	ve_sw_wr2buf {
		compatible = "ve_sw_wr2buf";
		interrupts = <0x0 0x62 0x4>;
	};

	FIQ_EMM_ECM {
		compatible = "FIQ_EMM_ECM";
		interrupts = <0x0 0x63 0x4>;
	};
	host0_int {
		compatible = "host0_int";
		interrupts = <0x0 0x64 0x4  0x0 0x65 0x4  0x0 0x66 0x4>;
	};

	host1_int {
		compatible = "host1_int";
		interrupts = <0x0 0x68 0x4  0x0 0x69 0x4  0x0 0x6a 0x4>;
	};

	host2_int {
		compatible = "host2_int";
		interrupts = <0x0 0x6c 0x4  0x0 0x6d 0x4  0x0 0x6e 0x4>;
	};

	host3_int {
		compatible = "host3_int";
		interrupts = <0x0 0x70 0x4  0x0 0x71 0x4  0x0 0x72 0x4>;
	};

	hdmi_tx_fiq {
		compatible = "hdmi_tx_fiq";
		interrupts = <0x0 0x76 0x4>;
	};

	crypto_dma {
		compatible = "crypto_dma";
		interrupts = <0x0 0x78 0x4>;
	};

	frm_pm_fiq {
		compatible = "frm_pm_fiq";
		interrupts = <0x0 0x7f 0x4>;
	};


	miic2_int {
		compatible = "miic2_int";
		interrupts = <0x0 0xa0 0x4>;
	};

	miic3_int {
		compatible = "miic3_int";
		interrupts = <0x0 0xa1 0x4>;
	};

	miic4_int {
		compatible = "miic4_int";
		interrupts = <0x0 0xa2 0x4>;
	};

	TSIO_LOC_DEC {
		compatible = "TSIO_LOC_DEC";
		interrupts = <0x0 0xa3 0x4>;
	};
	hdmi_tx_phy {
		compatible = "hdmi_tx_phy";
		interrupts = <0x0 0xa4 0x4>;
	};


	ge {
		compatible = "ge";
		interrupts = <0x0 0xa5 0x4>;
	};

	miu_sec {
		compatible = "miu_sec";
		interrupts = <0x0 0xa6 0x4>;
	};

	U3_PHY {
		compatible = "U3_PHY";
		interrupts = <0x0 0xa7 0x4>;
	};
	irq-mali {
		compatible = "mstar-mali";
		interrupts = <0x0 0xa8 0x4>;
	};

        cmdq {
		compatible = "cmdq";
		interrupts = <0x0 0xa9 0x4>;
	};
        
        audmav2 {
		compatible = "audmav2";
		interrupts = <0x0 0xaa 0x4>;
	};

        scdcpm {
		compatible = "scdcpm";
		interrupts = <0x0 0xab 0x4>;
	};

        mspi2 {
		compatible = "mspi2";
		interrupts = <0x0 0xac 0x4>;
	};

        smart0 {
		compatible = "smart0";
		interrupts = <0x0 0xad 0x4>;
	};
        smart1 {
		compatible = "smart1";
		interrupts = <0x0 0xae 0x4>;
	};

        dcsub {
		compatible = "dcsub";
		interrupts = <0x0 0xaf 0x4>;
	};

	sdio {
		compatible = "sdio";
		interrupts = <0x0 0xb0 0x4>;
	};

        USB30_SS {
		compatible = "USB30_SS";
		interrupts = <0x0 0xb1 0x4>;
	};
        MIU_CMA_CLR {
		compatible = "MIU_CMA_CLR";
		interrupts = <0x0 0xb2 0x4>;
	};
	TSP_SPARE {
		compatible = "TSP_SPARE";
		interrupts = <0x0 0xb3 0x0>;
	};
	Mstar-xhci-1 {
		compatible = "Mstar-xhci-1";
		interrupts = <0x0 0xb4 0x0>;
	};
	Mstar-ehci-3 {
		compatible = "Mstar-ehci-3";
		interrupts = <0x0 0xb5 0x0>;
	};

	MIU_NS {
		compatible = "MIU_NS";
		interrupts = <0x0 0xb8 0x0>;
	};

	pe2rc {
		compatible = "pe2rc";
		interrupts = <0x0 0xb9 0x0>;
	};

	v9muial {
		compatible = "v9muial";
		interrupts = <0x0 0xba 0x0>;
	};

	sdio_osp {
		compatible = "sdio_osp";
		interrupts = <0x0 0xbb 0x0>;
	};

	dip {
		compatible = "dip";
		interrupts = <0x0 0xbd 0x0>;
	};

	diamond_rxiu {
		compatible = "diamond_rxiu";
		interrupts = <0x0 0xbe 0x0>;
	};

        pas_pts_intrl {
		compatible = "pas_pts_intrl";
		interrupts = <0x0 0xbf 0x0>;
	};



	sec_guard_int {
		compatible = "sec_guard_int";
		interrupts = <0x0 0xc0 0x0>;
	};

	sd_cdz {
		compatible = "sd_cdz";
		interrupts = <0x0 0xc1 0x0>;
	};

	usb_p0 {
		compatible = "usb_p0";
		interrupts = <0x0 0xcc 0x0>;
	};

	mstar_WiFi {
		compatible = "mstar_WiFi";
		interrupts = <0x0 0xc3 0x0>;
	};

	uhc_p0 {
		compatible = "uhc_p0";
		interrupts = <0x0 0xcd 0x0>;
	};

	otg_in_p0 {
		compatible = "uhc_p0";
		interrupts = <0x0 0xcf 0x0>;
	};

	usb_p1 {
		compatible = "usb_p1";
		interrupts = <0x0 0xd0 0x0>;
	};

	uhc_p1 {
		compatible = "uhc_p1";
		interrupts = <0x0 0xd1 0x0>;
	};


	alsa {
		compatible = "Mstar-alsa";
	};

	rtc {
		compatible = "mstar-rtc";
	};

	gpio {
            compatible = "mstar,gpio";
            gpio-controller;
            #gpio-cells = <0x1>;
            interrupt-controller;
            #interrupt-cells = <0x2>;
        };

	xc {
		compatible = "mstar-xc";
	};
	
	sata_host {
		compatible = "mstar-sata";
		interrupts = <0x2f 0xf 0x4>;
		mstar,hba-base =  <0x102B00>;
		mstar,port-base = <0x102C00>;
		mstar,misc-base = <0x102D00>;
	};

	Mstar-utopia2k-str {
		compatible = "Mstar-utopia2k-str";
		mhl {
		  resume {
		    stage0 {
		      pre-condition = "hdmi_rx";
		    };
		  };
		};
		hdmi_rx {
		  resume {
		    stage0 {
		      post-condition = "hdmi_rx";
		    };
		  };
		};
		avd {
		  resume {
		    stage0 {
		      pre-condition = "vif";
		      post-condition = "avd";
		    };
		  };
		};
		vif {
		  resume {
		    stage0 {
		      post-condition = "vif";
		    };
		  };
		};
		vdec {
		  resume {
		    stage0 {
		      post-condition = "vdec";
		    };
		  };
		};
		pq {
          suspend {
		    stage0 {
		      pre-condition = "xc";
		    };
		  };
		  resume {
		    stage0 {
		      pre-condition = "xc";
		    };
		  };
		};
		xc {
          suspend {
		    stage0 {
		      post-condition = "xc";
		    };
		  };
		  resume {
		    stage0 {
		      pre-condition = "vdec","avd";
		      post-condition = "xc";
		    };
		  };
		};
        miu {
          resume {
            stage0 {
              post-condition = "miu";
            };
          };
        };
	};		    
	firmware {

		android {
			compatible = "android,firmware";
			hardware = "k6";
			revision = "1234";
			Serial = "0000000000000000";
			Processor = "AArch64 Processor rev 3 (aarch64)";
			serialno = "123456789";
			mode = "123456789";
			baseband = "123456789";
			bootloader = "123456789";

			fstab {
				compatible = "android,fstab";

				system {
					compatible = "android,system";
					dev = "/dev/block/platform/mstar_mci.0/by-name/system";
					type = "ext4";
					mnt_flags = "ro";
					fsmgr_flags = "wait";
				};

				vendor {
					compatible = "android,system";
					dev = "/dev/block/platform/mstar_mci.0/by-name/vendor";
					type = "ext4";
					mnt_flags = "ro";
					fsmgr_flags = "wait";
				};
			};
		};
	};

	switch_gpio {
		compatible = "mstar,switch-gpio";
		switch-name = "h2w";
		switch-gpio = <999>;
		switch-inverse = <0>;
	};

        i2c0: i2c@0 {
            compatible = "mstar,swi2c";
            bus-index = <0>;
            sda-gpio = <32>;
            scl-gpio = <31>;
            speed-khz = <100>;
            def-delay = <100>;
            retries = <5>;
            status = "okay";
            iic-mode = <1>;
            hw-port = <5>;
            pad-mux = <42>;
        };

        mstar_sensor0: mstar-sensor@0 {
                compatible = "mstar-thermal";
                #thermal-sensor-cells = <1>;
        };

        thermal-zones {
                mstar_thermal: mstar-thermal {
                        polling-delay = <1000>;
                        polling-delay-passive = <100>;
                        sustainable-power = <1100 1500 3400>;

                        thermal-sensors = <&mstar_sensor0 0>;
                        trips {
                                threshold: trip-point@0 {
                                        temperature = <110000>;
                                        hysteresis = <1000>;
                                        type = "passive";
                                };
                                target: trip-point@1 {
                                        temperature = <120000>;
                                        hysteresis = <1000>;
                                        type = "passive";
                                };
                        };
                        cooling-maps {
                                map0 {
                                        trip = <&target>;
                                        contribution = <1024>;
                                        cooling-device = <&cluster0 THERMAL_NO_LIMIT THERMAL_NO_LIMIT>;
                                };

                        };
                };
        };
};
