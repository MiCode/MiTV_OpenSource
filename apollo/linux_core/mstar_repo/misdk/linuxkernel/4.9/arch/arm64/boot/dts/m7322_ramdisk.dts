/*
 * ARM Ltd.
 *
 * ARMv8 Foundation model DTS
 */

/dts-v1/;
/ {
	model = "M7322";
	compatible = "arm,foundation-aarch64", "arm,m7322";
	interrupt-parent = <&gic>;
	#address-cells = <2>;
	#size-cells = <2>;

    /* rdinit=/sbin/init */
	chosen {
         bootargs = "root=/dev/ram0 rw init=/sbin/init ip=dhcp console=ttyS0,38400,LX_MEM=0x03000000";
        };

	cpus {
		#address-cells = <2>;
		#size-cells = <0>;

		cpu@0 {
			device_type = "cpu";
			compatible = "arm,armv8";
			reg = <0x0 0x0>;
			enable-method = "mstar-spin-table";
			cpu-release-addr = <0x0 0x00100510>;
		};
		cpu@1 {
			device_type = "cpu";
			compatible = "arm,armv8";
			/* reg = <0x0 0x1>; */
			/* 0x0 is high 32bit, 0x100 is low 32bit ==> this means this cpu's CPUID (MPIDR_EL1)*/
			reg = <0x0 0x100>;
			enable-method = "mstar-spin-table";
			cpu-release-addr = <0x0 0x00100510>;
		};
		cpu@2 {
                        device_type = "cpu";
                        compatible = "arm,armv8";
                        /* reg = <0x0 0x1>; */
                        /* 0x0 is high 32bit, 0x100 is low 32bit ==> this means this cpu's CPUID (MPIDR_EL1)*/
                        reg = <0x0 0x200>;
                        enable-method = "mstar-spin-table";
                        cpu-release-addr = <0x0 0x00100510>;
                };
		cpu@3 {
                        device_type = "cpu";
                        compatible = "arm,armv8";
                        /* reg = <0x0 0x1>; */
                        /* 0x0 is high 32bit, 0x100 is low 32bit ==> this means this cpu's CPUID (MPIDR_EL1)*/
                        reg = <0x0 0x300>;
                        enable-method = "mstar-spin-table";
                        cpu-release-addr = <0x0 0x00100510>;
                };
	};

	memory@20200000 {
		device_type = "memory";
		reg = <0x00000000 0x20200000 0x00000000 0x08000000>;
	};

	gic: interrupt-controller@16001000 {
		compatible = "arm,cortex-a15-gic", "arm,cortex-a9-gic";
		#interrupt-cells = <3>;
		#address-cells = <0>;
		interrupt-controller;
		reg = <0x0 0x16001000 0 0x1000>,
		      <0x0 0x16002000 0 0x4000>;
		interrupts = <1 9 0xf04>;
	};

    uart0 {
        compatible = "mstar8250-uart";
        interrupts = <0x0 0x0 0x4>;
    };

	pm_sleep_int { 
		compatible = "pm_sleep_int";
		interrupts = <0x0 0x1 0x4>;
	};

	irq_vd_evd_r22hi {
		compatible = "irq_vd_evd_r22hi";
		interrupts = <0x0 0x2 0x4>;
	};

	mvd_int {
		compatible = "mvd_int";
		interrupts = <0x0 0x3 0x4>;
	};

	ps_int {
		compatible = "ps_int";
		interrupts = <0x0 0x4 0x4>;
	};

	nfie_int {
		compatible = "nfie_int";
		interrupts = <0x0 0x5 0x4>;
	};

	usb_int {
		compatible = "usb_int";
		interrupts = <0x0 0x6 0x4>;
	};

	uhc_int {
		compatible = "uhc_int";
		interrupts = <0x0 0x7 0x4>;
	};

	lpll_intr {
		compatible = "lpll_intr";
		interrupts = <0x0 0x8 0x4>;
	};

	emac_int {
		compatible = "emac_int";
		interrupts = <0x0 0x9 0x4>;
	};

	disp_be_int {
		compatible = "disp_be_int";
		interrupts = <0x0 0xa 0x4>;
	};

	mspi_int {
		compatible = "mspi_int";
		interrupts = <0x0 0xb 0x4>;
	};

	ge_int {
		compatible = "ge_int";
		interrupts = <0x0 0xc 0x4>;
	};

	evd_int {
		compatible = "evd_int";
		interrupts = <0x0 0xd 0x4>;
	};

	comb_int {
		compatible = "comb_int";
		interrupts = <0x0 0xe 0x4>;
	};

	mod_detect_intr {
		compatible = "mod_detect_intr";
		interrupts = <0x0 0xf 0x4>;
	};

	tsp2hk_int {
		compatible = "tsp2hk_int";
		interrupts = <0x0 0x10 0x4>;
	};

	cec_int_pm {
		compatible = "cec_int_pm";
		interrupts = <0x0 0x11 0x4>;
	};

	disp_fe_int {
		compatible = "disp_fe_int";
		interrupts = <0x0 0x12 0x4>;
	};

	dc_int {
		compatible = "dc_int";
		interrupts = <0x0 0x13 0x4>;
	};

	gop_int {
		compatible = "gop_int";
		interrupts = <0x0 0x14 0x4>;
	};

	scdc_int_pm {
		compatible = "scdc_int_pm";
		interrupts = <0x0 0x15 0x4>;
	};

	otg_int {
		compatible = "otg_int";
		interrupts = <0x0 0x16 0x4>;
	};

	d2b_int {
		compatible = "d2b_int";
		interrupts = <0x0 0x17 0x4>;
	};

	AUDMA_V2_INTR {
		compatible = "AUDMA_V2_INTR";
		interrupts = <0x0 0x18 0x4>;
	};
/*
	1'b0 {
		compatible = "1'b0";
		interrupts = <0x0 0x19 0x4>;
	};
*/
	emmc_osp_int {
		compatible = "emmc_osp_int";
		interrupts = <0x0 0x1a 0x4>;
	};

	scm_int {
		compatible = "scm_int";
		interrupts = <0x0 0x1b 0x4>;
	};

	vbi_int {
		compatible = "vbi_int";
		interrupts = <0x0 0x1c 0x4>;
	};

	mvd2mips_int {
		compatible = "mvd2mips_int";
		interrupts = <0x0 0x1d 0x4>;
	};

	gpd_int {
		compatible = "gpd_int";
		interrupts = <0x0 0x1e 0x4>;
	};

	tso_int {
		compatible = "tso_int";
		interrupts = <0x0 0x1f 0x4>;
	};

	hvd_int {
		compatible = "hvd_int";
		interrupts = <0x0 0x20 0x4>;
	};

	usb_int1 {
		compatible = "usb_int1";
		interrupts = <0x0 0x21 0x4>;
	};

	miu_int {
		compatible = "miu_int";
		interrupts = <0x0 0x22 0x4>;
	};

	error_resp_int {
		compatible = "error_resp_int";
		interrupts = <0x0 0x23 0x4>;
	};

	usb_int2 {
		compatible = "usb_int2";
		interrupts = <0x0 0x24 0x4>;
	};

	rtc2_int {
		compatible = "rtc2_int";
		interrupts = <0x0 0x25 0x4>;
	};

	aesdma_s_int {
		compatible = "aesdma_s_int";
		interrupts = <0x0 0x26 0x4>;
	};

	int_uart1 {
		compatible = "int_uart1";
		interrupts = <0x0 0x27 0x4>;
	};

	disp_mfdec_int {
		compatible = "disp_mfdec_int";
		interrupts = <0x0 0x28 0x4>;
	};

	mspi_cilink_int {
		compatible = "mspi_cilink_int";
		interrupts = <0x0 0x29 0x4>;
	};

	miu_security_int {
		compatible = "miu_security_int";
		interrupts = <0x0 0x2a 0x4>;
	};

	dipw_INT {
		compatible = "dipw_INT";
		interrupts = <0x0 0x2b 0x4>;
	};

	miic2_int {
		compatible = "miic2_int";
		interrupts = <0x0 0x2c 0x4>;
	};

	jpd_int {
		compatible = "jpd_int";
		interrupts = <0x0 0x2d 0x4>;
	};

	pm_irq_out {
		compatible = "pm_irq_out";
		interrupts = <0x0 0x2e 0x4>;
	};

	pka_all_int {
		compatible = "pka_all_int";
		interrupts = <0x0 0x2f 0x4>;
	};

	int_bdma_merge {
		compatible = "int_bdma_merge";
		interrupts = <0x0 0x30 0x4>;
	};

	PAS_PTS_INTRL_COMBINE {
		compatible = "PAS_PTS_INTRL_COMBINE";
		interrupts = <0x0 0x31 0x4>;
	};

	uart2mcu_intr {
		compatible = "uart2mcu_intr";
		interrupts = <0x0 0x32 0x4>;
	};

	urdma2mcu_intr {
		compatible = "urdma2mcu_intr";
		interrupts = <0x0 0x33 0x4>;
	};

	dvi_hdmi_hdcp_int {
		compatible = "dvi_hdmi_hdcp_int";
		interrupts = <0x0 0x34 0x4>;
	};

	g3d2mcu_irq_dft {
		compatible = "g3d2mcu_irq_dft";
		interrupts = <0x0 0x35 0x4>;
	};

	fcie_tee_int {
		compatible = "fcie_tee_int";
		interrupts = <0x0 0x36 0x4>;
	};

	smart_int {
		compatible = "smart_int";
		interrupts = <0x0 0x37 0x4>;
	};

	hdcp_x74_int {
		compatible = "hdcp_x74_int";
		interrupts = <0x0 0x38 0x4>;
	};

	wadr_err_int {
		compatible = "wadr_err_int";
		interrupts = <0x0 0x39 0x4>;
	};

	ve_int {
		compatible = "ve_int";
		interrupts = <0x0 0x3a 0x4>;
	};

	sdio_int {
		compatible = "sdio_int";
		interrupts = <0x0 0x3b 0x4>;
	};

	acpu_int {
		compatible = "acpu_int";
		interrupts = <0x0 0x3c 0x4>;
	};

	miic1_int {
		compatible = "miic1_int";
		interrupts = <0x0 0x3d 0x4>;
	};

	usb_int3 {
		compatible = "usb_int3";
		interrupts = <0x0 0x3e 0x4>;
	};

	miic0_int {
		compatible = "miic0_int";
		interrupts = <0x0 0x3f 0x4>;
	};

	int_timer0 {
		compatible = "int_timer0";
		interrupts = <0x0 0x40 0x4>;
	};

	int_timer1 {
		compatible = "int_timer1";
		interrupts = <0x0 0x41 0x4>;
	};

	int_wdt {
		compatible = "int_wdt";
		interrupts = <0x0 0x42 0x4>;
	};

	usb_int_merge3 {
		compatible = "usb_int_merge3";
		interrupts = <0x0 0x43 0x4>;
	};

	AU_SPDIF_TX_CS_INT0 {
		compatible = "AU_SPDIF_TX_CS_INT0";
		interrupts = <0x0 0x44 0x4>;
	};

	AU_SPDIF_TX_CS_INT1 {
		compatible = "AU_SPDIF_TX_CS_INT1";
		interrupts = <0x0 0x45 0x4>;
	};

	MB_DSP2toMCU_INT0 {
		compatible = "MB_DSP2toMCU_INT0";
		interrupts = <0x0 0x46 0x4>;
	};

	MB_DSP2toMCU_INT1 {
		compatible = "MB_DSP2toMCU_INT1";
		interrupts = <0x0 0x47 0x4>;
	};

	usb_int_fiq {
		compatible = "usb_int_fiq";
		interrupts = <0x0 0x48 0x4>;
	};

	uhc_int_fiq {
		compatible = "uhc_int_fiq";
		interrupts = <0x0 0x49 0x4>;
	};

	ve_done_TT_irq {
		compatible = "ve_done_TT_irq";
		interrupts = <0x0 0x4a 0x4>;
	};

	HDMI_NON_PCM_MODE_INT_OUT {
		compatible = "HDMI_NON_PCM_MODE_INT_OUT";
		interrupts = <0x0 0x4b 0x4>;
	};

	SPDIF_IN_NON_PCM_INT_OUT {
		compatible = "SPDIF_IN_NON_PCM_INT_OUT";
		interrupts = <0x0 0x4c 0x4>;
	};

	lan_esd_int {
		compatible = "lan_esd_int";
		interrupts = <0x0 0x4d 0x4>;
	};

	SE_DSP2UP_intr {
		compatible = "SE_DSP2UP_intr";
		interrupts = <0x0 0x4e 0x4>;
	};

	tsp2aeon_int {
		compatible = "tsp2aeon_int";
		interrupts = <0x0 0x4f 0x4>;
	};

	vivaldi_str_intr {
		compatible = "vivaldi_str_intr";
		interrupts = <0x0 0x50 0x4>;
	};

	vivaldi_pts_intr {
		compatible = "vivaldi_pts_intr";
		interrupts = <0x0 0x51 0x4>;
	};

	DSP_MIU_PROT_intr {
		compatible = "DSP_MIU_PROT_intr";
		interrupts = <0x0 0x52 0x4>;
	};

	xiu_timeout_int {
		compatible = "xiu_timeout_int";
		interrupts = <0x0 0x53 0x4>;
	};

	dmdmcu2hk_int {
		compatible = "dmdmcu2hk_int";
		interrupts = <0x0 0x54 0x4>;
	};

	ir_in {
		compatible = "ir_in";
		interrupts = <0x0 0x55 0x4>;
	};

	imi_top_irq {
		compatible = "imi_top_irq";
		interrupts = <0x0 0x56 0x4>;
	};

	vdmcu2hk_int {
		compatible = "vdmcu2hk_int";
		interrupts = <0x0 0x57 0x4>;
	};

	ldm_dma_done_int0 {
		compatible = "ldm_dma_done_int0";
		interrupts = <0x0 0x58 0x4>;
	};

	ldm_dma_done_int1 {
		compatible = "ldm_dma_done_int1";
		interrupts = <0x0 0x59 0x4>;
	};

	PM_SD_CDZ_int {
		compatible = "PM_SD_CDZ_int";
		interrupts = <0x0 0x5a 0x4>;
	};

	MB_auR2toMCU_INT0 {
		compatible = "MB_auR2toMCU_INT0";
		interrupts = <0x0 0x5b 0x4>;
	};

	AFEC_VSYNC {
		compatible = "AFEC_VSYNC";
		interrupts = <0x0 0x5c 0x4>;
	};

	MB_auR2toMCU_INT1 {
		compatible = "MB_auR2toMCU_INT1";
		interrupts = <0x0 0x5d 0x4>;
	};

	MB_auR2toMCU_INT2 {
		compatible = "MB_auR2toMCU_INT2";
		interrupts = <0x0 0x5e 0x4>;
	};

	DSP2MIPS_INT {
		compatible = "DSP2MIPS_INT";
		interrupts = <0x0 0x5f 0x4>;
	};

	MB_auR2toMCU_INT3 {
		compatible = "MB_auR2toMCU_INT3";
		interrupts = <0x0 0x60 0x4>;
	};

	AU_DMA_BUFFER_INT_EDGE {
		compatible = "AU_DMA_BUFFER_INT_EDGE";
		interrupts = <0x0 0x61 0x4>;
	};

	int_all {
		compatible = "int_all";
		interrupts = <0x0 0x62 0x4>;
	};

	PM_SD_CDZ1_int {
		compatible = "PM_SD_CDZ1_int";
		interrupts = <0x0 0x63 0x4>;
	};

	reg_hst0to3_int {
		compatible = "reg_hst0to3_int";
		interrupts = <0x0 0x64 0x4>;
	};

	reg_hst0to2_int {
		compatible = "reg_hst0to2_int";
		interrupts = <0x0 0x65 0x4>;
	};

	reg_hst0to1_int {
		compatible = "reg_hst0to1_int";
		interrupts = <0x0 0x66 0x4>;
	};

	ext_gpio_int0 {
		compatible = "ext_gpio_int0";
		interrupts = <0x0 0x67 0x4>;
	};

	reg_hst1to3_int {
		compatible = "reg_hst1to3_int";
		interrupts = <0x0 0x68 0x4>;
	};

	emac_man_int {
		compatible = "emac_man_int";
		interrupts = <0x0 0x69 0x4>;
	};

	reg_hst1to0_int {
		compatible = "reg_hst1to0_int";
		interrupts = <0x0 0x6a 0x4>;
	};

	ext_gpio_int1 {
		compatible = "ext_gpio_int1";
		interrupts = <0x0 0x6b 0x4>;
	};

	reg_hst2to3_int {
		compatible = "reg_hst2to3_int";
		interrupts = <0x0 0x6c 0x4>;
	};

	int_timer2 {
		compatible = "int_timer2";
		interrupts = <0x0 0x6d 0x4>;
	};

	reg_hst2to0_int {
		compatible = "reg_hst2to0_int";
		interrupts = <0x0 0x6e 0x4>;
	};

	ext_gpio_int2 {
		compatible = "ext_gpio_int2";
		interrupts = <0x0 0x6f 0x4>;
	};

	reg_hst3to2_int {
		compatible = "reg_hst3to2_int";
		interrupts = <0x0 0x70 0x4>;
	};

	reg_hst3to1_int {
		compatible = "reg_hst3to1_int";
		interrupts = <0x0 0x71 0x4>;
	};

	reg_hst3to0_int {
		compatible = "reg_hst3to0_int";
		interrupts = <0x0 0x72 0x4>;
	};

	usb_int_merge1 {
		compatible = "usb_int_merge1";
		interrupts = <0x0 0x73 0x4>;
	};

	ve_vbi_f0_int {
		compatible = "ve_vbi_f0_int";
		interrupts = <0x0 0x74 0x4>;
	};

	usb_int_merge2 {
		compatible = "usb_int_merge2";
		interrupts = <0x0 0x75 0x4>;
	};

	ve_vbi_f1_int {
		compatible = "ve_vbi_f1_int";
		interrupts = <0x0 0x76 0x4>;
	};

	ext_gpio_int3 {
		compatible = "ext_gpio_int3";
		interrupts = <0x0 0x77 0x4>;
	};

	ext_gpio_int4 {
		compatible = "ext_gpio_int4";
		interrupts = <0x0 0x78 0x4>;
	};

	ext_gpio_int5 {
		compatible = "ext_gpio_int5";
		interrupts = <0x0 0x79 0x4>;
	};

	ext_gpio_int6 {
		compatible = "ext_gpio_int6";
		interrupts = <0x0 0x7a 0x4>;
	};

	pwm_rp_l_int {
		compatible = "pwm_rp_l_int";
		interrupts = <0x0 0x7b 0x4>;
	};

	pwm_fp_l_int {
		compatible = "pwm_fp_l_int";
		interrupts = <0x0 0x7c 0x4>;
	};

	pwm_rp_r_int {
		compatible = "pwm_rp_r_int";
		interrupts = <0x0 0x7d 0x4>;
	};

	pwm_fp_r_int {
		compatible = "pwm_fp_r_int";
		interrupts = <0x0 0x7e 0x4>;
	};

	ext_gpio_int7 {
		compatible = "ext_gpio_int7";
		interrupts = <0x0 0x7f 0x4>;
	};

	miic3_int {
		compatible = "miic3_int";
		interrupts = <0x0 0xa6 0x4>;
	};

	miic4_int {
		compatible = "miic4_int";
		interrupts = <0x0 0xa7 0x4>;
	};

	miic5_int {
		compatible = "miic5_int";
		interrupts = <0x0 0xa8 0x4>;
	};

	int_uart2 {
		compatible = "int_uart2";
		interrupts = <0x0 0xa9 0x4>;
	};

	int_uart3 {
		compatible = "int_uart3";
		interrupts = <0x0 0xaa 0x4>;
	};

	int_uart4 {
		compatible = "int_uart4";
		interrupts = <0x0 0xab 0x4>;
	};

	mfe_int {
		compatible = "mfe_int";
		interrupts = <0x0 0xac 0x4>;
	};

	cmdq_int {
		compatible = "cmdq_int";
		interrupts = <0x0 0xad 0x4>;
	};

	pcm2mcu_int {
		compatible = "pcm2mcu_int";
		interrupts = <0x0 0xae 0x4>;
	};
/*
	1'b0 {
		compatible = "1'b0";
		interrupts = <0x0 0xaf 0x4>;
	};

	1'b0 {
		compatible = "1'b0";
		interrupts = <0x0 0xb0 0x4>;
	};
*/
	ci_gpio_int {
		compatible = "ci_gpio_int";
		interrupts = <0x0 0xb1 0x4>;
	};

	cilink_soc_if {
		compatible = "cilink_soc_if";
		interrupts = <0x0 0xb2 0x4>;
	};

	tsp_fi_queue_int {
		compatible = "tsp_fi_queue_int";
		interrupts = <0x0 0xb3 0x4>;
	};

	tsen_0_ov_irq {
		compatible = "tsen_0_ov_irq";
		interrupts = <0x0 0xb4 0x4>;
	};

	tsen_1_ov_irq {
		compatible = "tsen_1_ov_irq";
		interrupts = <0x0 0xb5 0x4>;
	};

	timer {
		compatible = "arm,armv8-timer";
		interrupts = <1 13 0xff01>,
			     <1 14 0xff01>,
			     <1 11 0xff01>,
			     <1 10 0xff01>;
		clock-frequency = <12000000>;
	};

	pmu {
		compatible = "arm,armv8-pmuv3";
		interrupts = <0x0 0x86 0x4>,
			     <0x0 0x88 0x4>,
			     <0x0 0x8a 0x4>,
			     <0x0 0x8c 0x4>;
	};

	emac {
	        compatible = "mstar-emac";
	};

	ir {
	        compatible = "mstar-ir";
	};

	Mstar-ehci-1 {
		compatible = "Mstar-ehci-1";
	};

	Mstar-ehci-2 {
		compatible = "Mstar-ehci-2";
	};

	Mstar-ehci-3 {
		compatible = "Mstar-ehci-3";
	};

	Mstar-ehci-4 {
		compatible = "Mstar-ehci-4";
	};

	alsa {
		compatible = "Mstar-alsa";
	};

	mstar-rtc@0 {
		compatible = "mstar-rtc";
		index = <0>;
		xtal = <12000000>;
		freq = <1>;
	};

	mstar-pm {
		compatible = "mstar-pm";
	};

	mbx {
		compatible = "mstar-mbx";
	};

	mvd {
		compatible = "mvd";
	};

	ps {
		compatible = "Mstar-mvd";
	};

	Mstar-usb {
		compatible = "Mstar-usb";
	};

	scaler {
		compatible = "mstar-scaler";
	};

	mstar-tsp {
		compatible = "Mstar-tsp";
	};

	gflip {
		compatible = "mstar-gflip";
	};

	hdmitx4vx1 {
		compatible = "mstar-hdmitx4vx1";
	};

	xc {
		compatible = "mstar-xc";
	};

	bdma_merge {
		compatible = "Mstar-dipw";
	};

	Mstar-udc {
		compatible = "Mstar-udc";
	};

	Mstar-otg {
		compatible = "Mstar-otg";
	};

	Mstar-utopia2k-str {
		compatible = "Mstar-utopia2k-str";

		mhl {

			resume {

				stage0 {
					pre-condition = "hdmi_rx";
				};
			};
		};

		hdmi_rx {

			resume {

				stage0 {
					post-condition = "hdmi_rx";
				};
			};
		};

		avd {
			resume {

				stage0 {
					pre-condition = "vif";
				};
			};
		};

		vif {

			resume {

				stage0 {
					post-condition = "vif";
				};
			};
		};
	};

        Mstar-sys {
                firmware {
                        audio {
                                path = "/mslib/utopia/";
                        };
                };
        };

	firmware {

		android {
			compatible = "android,firmware";
			hardware = "m7322";
			revision = "1234";
			Serial = "0000000000000000";
			Processor = "AArch64 Processor rev 3 (aarch64)";
			serialno = "123456789";
			mode = "123456789";
			baseband = "123456789";
			bootloader = "123456789";
			fstab {
				compatible = "android,fstab";
				system {
					compatible = "android,system";
					dev = "/dev/block/platform/mstar_mci.0/by-name/system";
					type = "ext4";
					mnt_flags = "ro";
					fsmgr_flags = "wait";
				};
				vendor {
					compatible = "android,system";
					dev = "/dev/block/platform/mstar_mci.0/by-name/vendor";
					type = "ext4";
					mnt_flags = "ro";
					fsmgr_flags = "wait";
				};
			};
		};
	};

	switch_gpio {
		compatible = "mstar,switch-gpio";
		switch-name = "h2w";
		switch-gpio = <999>;
		switch-inverse = <0>;
	};

	gpio: gpio {
		compatible = "mstar,gpio";
		gpio-controller;
		#gpio-cells = <1>;
		interrupt-controller;
		skip-save-status = <5 27>;
		#interrupt-cells = <2>; /* cell name GPIO_PAD, trigger-type*/
	};

	i2c0: i2c@0 {
		compatible = "mstar,swi2c";
		bus-index = <0>;
		sda-gpio = <37>;
		scl-gpio = <36>;
		speed-khz = <100>;
		def-delay = <100>;
		retries = <5>;
		status = "okay";
		iic-mode = <1>;
		hw-port = <3>;
		pad-mux = <25>;
	};

	i2c1: i2c@1 {
		compatible = "mstar,swi2c";
		bus-index = <1>;
		sda-gpio = <118>;
		scl-gpio = <117>;
		speed-khz = <100>;
		def-delay = <100>;
		retries = <5>;
		status = "okay";
		iic-mode = <0>;
		hw-port = <0>;
		pad-mux = <0>;
	};
};
