## kernel/drivers/block/zram/Kconfig
```kconfig
# SPDX-License-Identifier: GPL-2.0
config ZRAM
	tristate "Compressed RAM block device support"
	depends on BLOCK && SYSFS && ZSMALLOC && CRYPTO
	select CRYPTO_LZO
	default n
	help
	  Creates virtual block devices called /dev/zramX (X = 0, 1, ...).
	  Pages written to these disks are compressed and stored in memory
	  itself. These disks allow very fast I/O and compression provides
	  good amounts of memory savings.

	  It has several use cases, for example: /tmp storage, use as swap
	  disks and maybe many more.

	  See Documentation/blockdev/zram.txt for more information.

config ZRAM_WRITEBACK
       bool "Write back incompressible or idle page to backing device"
       depends on ZRAM
       default n
       help
	 With incompressible page, there is no memory saving to keep it
	 in memory. Instead, write it out to backing device.
	 For this feature, admin should set up backing device via
	 /sys/block/zramX/backing_dev.

	 With /sys/block/zramX/{idle,writeback}, application could ask
	 idle page's writeback to the backing device to save in memory.

	 See Documentation/blockdev/zram.txt for more information.

config ZRAM_MEMORY_TRACKING
	bool "Track zRam block status"
	depends on ZRAM && DEBUG_FS
	help
	  With this feature, admin can track the state of allocated blocks
	  of zRAM. Admin could see the information via
	  /sys/kernel/debug/zram/zramX/block_state.

	  See Documentation/blockdev/zram.txt for more information.

config MP_ZSM
	bool "ZRAM same page merging"
	depends on ZRAM
	default y
	help
	  The maximum zram size for the implementation is about 1024MB-4KB (18bits).
	  This feature will find same page in zram and merge these same pages
	  in order to save memory with some zram execution overhead.
	  Turn on "ZSM" with "/sys/block/zram0/zsm_on"

config MP_ZSM_STAT
	bool "ZSM statistics"
	depends on MP_ZSM
	default y
	help
	  Providing basic statistics to show the influence of ZSM.

config MP_ZSM_DEBUG
	bool "ZSM debug information"
	depends on MP_ZSM
	default n
	help
	  Providing debug information of ZSM as histories for each zram_table_entry.
	  Also provide ZSM metadata verification.
```

## kernel/drivers/smaf/Kconfig
```kconfig
config SMAF
	tristate "Secure Memory Allocation Framework"
	depends on DMA_SHARED_BUFFER
	help
	  Choose this option to enable Secure Memory Allocation Framework

config SMAF_CMA
	tristate "SMAF CMA allocator"
	depends on SMAF && HAVE_DMA_ATTRS
	help
	  Choose this option to enable CMA allocation within SMAF

config SMAF_OPTEE
	tristate "SMAF optee secure module"
	depends on SMAF
	help
	  Choose this option to enable optee module within SMAF
```

## kernel/drivers/tee/optee/Kconfig
```kconfig
# OP-TEE Trusted Execution Environment Configuration
config OPTEE
	tristate "OP-TEE"
	depends on HAVE_ARM_SMCCC
	depends on MMU
	help
	  This implements the OP-TEE Trusted Execution Environment (TEE)
	  driver.

config OPTEE_SHM_NUM_PRIV_PAGES
	int "Private Shared Memory Pages"
	default 1
	depends on OPTEE
	help
	  This sets the number of private shared memory pages to be
	  used by OP-TEE TEE driver.

config TEE_2_4
	bool "Trusted Execution Environment support optee 2.4 exclusive of optee 1.0.1 "
	default n
	select OPTEE
	select GENERIC_ALLOCATOR
	select DMA_SHARED_BUFFER
	help
	  This implements a generic interface towards a Trusted Execution
	  Environment (TEE).

config TEE_3_2
        bool "Trusted Execution Environment support optee 3.2 exclusive of optee 1.0.1 "
        default n
        select OPTEE
        select TEE_2_4
        select GENERIC_ALLOCATOR
        select DMA_SHARED_BUFFER
        help
          This implements a generic interface towards a Trusted Execution
          Environment (TEE).
```
