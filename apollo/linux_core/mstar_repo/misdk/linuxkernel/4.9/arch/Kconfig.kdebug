## apollo/linux_core/mstar_repo/misdk/linuxkernel/4.9/arch/Kconfig.kdebug
```kconfig
menuconfig REDLION_DEBUG
       bool "REDLION DEBUG"
       default y
       depends on MP_DEBUG_TOOL_KDEBUG

if REDLION_DEBUG
menu "Redlion options"
comment "kernel 3.10.23"


config SERIAL_INPUT_MANIPULATION
    bool "Manipulate serial input in N_TTY"
    help
      Decide whether serial input by user is enabled or not.

config SERIAL_INPUT_DISABLE_STRING
    string "Serial input disable string"
    default "~~bye"
    depends on SERIAL_INPUT_MANIPULATION=y
    help
      Default string that disable serial input by user.

config SERIAL_INPUT_DEFAULT_SETUP_ENABLE
    bool "Serial input enable setup at boot"
    default y
    depends on SERIAL_INPUT_MANIPULATION=y

config SERIAL_INPUT_MANIPULATION_PORTNUM
    int "Serial input port line number"
    default 0
    depends on SERIAL_INPUT_MANIPULATION=y

config SERIAL_INPUT_ENABLE_HELP_MSG
    bool "Print help message for serial input"
    default y
    depends on SERIAL_INPUT_MANIPULATION=y

config KDEBUGD
        bool "KDEBUGD - core"
        default y
        depends on SHOW_FAULT_TRACE_INFO
        depends on SERIAL_INPUT_MANIPULATION
        help
         kdebugd - kernel debugging helper
         kdebugd is a good solution for kernel hacker who want to know
         kernel information easily.

config SHOW_FAULT_TRACE_INFO
	bool "Tmp for fixing compiling error"
	default y

config KDEBUGD_TRACE
            bool "KDEBUGD - backtrace"
            default y
        depends on KDEBUGD
        help
          kdebugd - backtrace
          1. Dump backtrace(User)

config KDEBUGD_FTRACE
    bool "KDEBUGD - Ftrace Support"
    default y
    depends on KDEBUGD
    select FTRACE
    select GENERIC_TRACER
    help
      Enable the kernel to trace every kernel function. This is done
      by using a compiler feature to insert a small, 5-byte No-Operation
      instruction at the beginning of every kernel function, which NOP
      sequence is then dynamically patched into a tracer call when
      tracing is enabled by the administrator. If it's runtime disabled
      (the bootup default), then the overhead of the instructions is very
      small and not measurable even in micro-benchmarks.

config KDEBUGD_FTRACE_HR_CLOCK
        bool "High resolution trace clock"
        depends on KDEBUGD_FTRACE
        default y

config FTRACE_DEFAULT_TRACER
    string "Default tracer(check help for details)"
    default "function"
    depends on KDEBUGD_FTRACE
    help
        Default tracer(function, function_graph, sched_switch,
		wakeup, irqsoff, preemptoff, stack, kmemtrace, branch)

config FTRACE_DEFAULT_TRACE_LIST
    string "Default trace list"
    default ""
    depends on KDEBUGD_FTRACE
    help
        Default trace list

config FTRACE_DEFAULT_TRACE_NOT_LIST
    string "Default trace not list"
    default ""
    depends on KDEBUGD_FTRACE
    help
        Default trace not list

config FTRACE_DEFAULT_TRACE_GRAPH_LIST
    string "Default trace graph list"
    default ""
    depends on KDEBUGD_FTRACE
    help
        Default trace graph list

config FTRACE_DEFAULT_TRACE_MODE
	int "Default trace mode(1 print,2 log)"
	default 1
    depends on KDEBUGD_FTRACE
    help
        Default trace mode

config FTRACE_DEFAULT_TRACE_OUTPUT_NUM_LINES
	int "Default trace output num lines(0 to FTRACE_MAX_OUTPUT_NUM_LINES)"
	default 0
    depends on KDEBUGD_FTRACE
    help
        Default trace output num lines

config FTRACE_DEFAULT_TRACE_OUTPUT_FILE_NAME
    string "Default trace output file name"
    default "/mtd_rwarea/trace.dat"
    depends on KDEBUGD_FTRACE
    help
        Default trace output file name

config FTRACE_DEFAULT_TRACE_SIZE_KB
    int "Default trace buffer size(kb)(1 to FTRACE_MAX_TRACE_SIZE_KB)"
    default 1
    depends on KDEBUGD_FTRACE
    help
        Default trace buffer size(kb)

config FTRACE_DEFAULT_TRACE_CPU_MASK
    int "Default trace cpu mask(1 to CONFIG_NR_CPUS)"
    default 3
	 depends on SMP
    depends on KDEBUGD_FTRACE
    help
        Default trace cpu mask
		 Binary value 11(Decimal 3) represents mask set for 1st and 2nd CPU.
		 By default CPU mask is 3.
		 This means tracing will be done for 1st and 2nd CPU both.

config FTRACE_TIMESTAMP_NSEC_STATUS
    int "Default timestamp nanosecond resolution"
    default 0
    depends on KDEBUGD_FTRACE_HR_CLOCK
    help
        Default timestamp nanosecond resolution
        By default it is disabled

config KDEBUGD_FUTEX
        bool "KDEBUGD - Futex List"
        default y
        depends on FUTEX
        depends on KDEBUGD
        help
          kdebugd - Futex List
          1. Dump the list of threads (with backtrace) waiting on futex

config KDEBUGD_MISC
        bool "KDEBUGD - miscellaneous functions"
        default y
        depends on KDEBUGD
        help
         kdebugd - kernel debugging helper
         1. A list of tasks and their relation information
         2. A list of tasks and their priority information
         3. A list of tasks and their inforamtion + backtrace(kernel)
         4. Turn On/Off O(1) Scheduler prints
         5. Dump task register with pid
         6. Dump task maps with pid
         7. Dump user stack with pid
         8. Trace thread execution(look at PC)
         9. Schedule history logger

config SHOW_TASK_STATE
            bool "Show task state"
            default y
        depends on KDEBUGD_MISC
        help
          kdebugd -A list of tasks and their relation information

config SHOW_TASK_PRIORITY
            bool "Show task priority"
            default y
        depends on KDEBUGD_MISC
        help
          kdebugd -A list of tasks and their priority  information


config TASK_STATE_BACKTRACE
            bool "Show task state backtrace"
            default y
        depends on KDEBUGD_MISC
        help
          kdebugd - A list of tasks and their inforamtion + backtrace(kernel).

config TASK_FOR_COREDUMP
            bool "Kill task to coredump"
            default y
        depends on KDEBUGD_MISC
        help
          kdebugd - Kill the task to create coredump

config SHOW_USER_THREAD_REGS
            bool "Dump task register with pids"
            default y
        depends on KDEBUGD_MISC
        help
          kdebugd - Dump task register with pid

config SHOW_USER_MAPS_WITH_PID
            bool "Dump task maps with pid "
            default y
        depends on KDEBUGD_MISC
        help
          kdebugd - Dump task maps with pid

config SHOW_USER_STACK_WITH_PID
            bool "Dump task stack with pid "
            default y
        depends on KDEBUGD_MISC
        help
          kdebugd - Dump task stack with pid

config VIRTUAL_TO_PHYSICAL
            bool "Usermode Virtual to Physical Address Converter"
            default y
        depends on KDEBUGD_MISC
        help
         kdebugd - converts user mode virtual address to physical address and dumps contents of given location

config MEMORY_VALIDATOR
            bool "Memory Value Watcher"
            default y
        depends on VIRTUAL_TO_PHYSICAL
        help
          kdebugd - Memory Value Watcher

config TRACE_THREAD_PC
            bool "Trace thread execution(look at PC)"
            default y
        depends on KDEBUGD_MISC
        help
          kdebugd - Trace thread execution(look at PC)

config SCHED_HISTORY
            bool "show schedule history"
            default y
        depends on KDEBUGD_MISC
        help
          kdebugd - Show schedule history logger

config KDEBUGD_COUNTER_MONITOR
           bool "KDEBUGD - counter monitor"
           default y
        depends on KDEBUGD
       help
          kdebugd - counter monitor
          1. CPU Usage
          2. CPU Usage for each thread
          3. Memory Usage
          4. Disk Usage
          5. Network Usage

config LPJ_MANUAL_SETTING
    bool "LPJ value manual setting"
    default y
    help
      Manually set the loops_per_jiffy value, to skip calibrating delay loop
      on boot to improve boot time.
      Pls note that for each architecture this value is different, therefore
      first run target without this patch to get value.
      Once value is found from boot message log, enable this option and
      assign value to "Manual LPJ value"

config LPJ_VALUE
    int "Manual LPJ Value"
    default 0
    depends on LPJ_MANUAL_SETTING=y
    help
      Find value for your architecture before setting this.
config KDEBUGD_CPUUSAGE_BUFFER_SIZE
        int "CPU usage buffer size"
        default 120
        depends on KDEBUGD_COUNTER_MONITOR

config KDEBUGD_TOPTHREAD_BUFFER_SIZE
        int "Topthread buffer size"
        default 120
        depends on KDEBUGD_COUNTER_MONITOR


config KDEBUGD_MEMUSAGE_BUFFER_SIZE
        int "Memory usage buffer size"
        default 120
        depends on KDEBUGD_COUNTER_MONITOR

config KDEBUGD_DISKUSAGE_BUFFER_SIZE
        int "Disk usage buffer size"
        default 120
        depends on KDEBUGD_COUNTER_MONITOR

config KDEBUGD_NETUSAGE_BUFFER_SIZE
        int "Network usage buffer size"
        default 120
        depends on KDEBUGD_COUNTER_MONITOR

config ELF_MODULE
        bool "KDEBUGD - ELF Module"
        default y
       depends on KDEBUGD

config DWARF_MODULE
        bool "DWARF Module"
        default y
       depends on ELF_MODULE

source "arch/Kconfig.oprofile"

endmenu # end of "Redlion options" menu
endif # end of "REDLION_DEBUG"
```

## apollo/linux_core/mstar_repo/misdk/linuxkernel/4.9/arch/Kconfig.oprofile
```kconfig
menu "Kernel Oprofile tool"
config ADVANCE_OPROFILE
       bool "KDEBUGD - Advance OProfile"
       default y
       depends on KDEBUGD
       depends on OPROFILE
	   depends on KDEBUGD_TRACE

config AOP_CYCLES_SAMPLING_PERIOD
       int "Sampling period if the Cycles counter is used for sampling"
       default 1000000
       depends on CACHE_ANALYZER && ADVANCE_OPROFILE

config AOP_INSTRUCTIONS_SAMPLING_PERIOD
        int "Sampling period if the Instructions counter is used for sampling"
        default 50000
        depends on CACHE_ANALYZER && ADVANCE_OPROFILE

config AOP_L1D_MISSES_SAMPLING_PERIOD
        int "Sampling period if the L1D misses counter is used for sampling"
        default 100
        depends on CACHE_ANALYZER && ADVANCE_OPROFILE

config AOP_L1I_MISSES_SAMPLING_PERIOD
        int "Sampling period if the L1I misses counter is used for sampling"
        default 1000
        depends on CACHE_ANALYZER && ADVANCE_OPROFILE

config AOP_DTLB_MISSES_SAMPLING_PERIOD
        int "Sampling period if the DTLB misses counter is used for sampling"
        default 1000
        depends on CACHE_ANALYZER && ADVANCE_OPROFILE

config AOP_ITLB_MISSES_SAMPLING_PERIOD
        int "Sampling period if the ITLB misses counter is used for sampling"
        default 100
        depends on CACHE_ANALYZER && ADVANCE_OPROFILE

config AOP_BPU_ERRORS_SAMPLING_PERIOD
        int "Sampling period if the BPU errors counter is used for sampling"
        default 1000
        depends on CACHE_ANALYZER && ADVANCE_OPROFILE

config AOP_AUTO_START
        bool "Advance OProfile Auto start"
        default n
        depends on ADVANCE_OPROFILE

config AOP_START_SEC
       int "Advance OProfile Auto start start sec"
       default 1
       depends on AOP_AUTO_START

config CACHE_ANALYZER
        bool "KDEBUGD - cache analyzer"
         default n
         depends on HW_PERF_EVENTS && KDEBUGD
         help
          use the hardware per counters to analyze and profile using AOP and pmu counter monitor.
endmenu
```

## apollo/linux_core/mstar_repo/misdk/linuxkernel/4.9/arch/arm/Kconfig.coredump
```kconfig
menu "Kernel Core Dump Tool"

config BINFMT_ELF_COMP
	bool "Kernel support for compressed ELF binaries(Ultimate Coredump)"
	default y

config SEPARATE_PRINTK_FROM_USER
    bool "It separate messages(printf, printk) between user and kernel."
    default y

config DUMP_USE_REGSET
    bool "Show address range including PC, LR"
    default y

endmenu
```

## apollo/linux_core/mstar_repo/misdk/linuxkernel/4.9/drivers/tee/Kconfig
```kconfig
# Generic Trusted Execution Environment Configuration
config TEE_2_4
	bool "Trusted Execution Environment support optee 2.4 exclusive of optee 1.0.1 "
	default n
	select OPTEE
	select GENERIC_ALLOCATOR
	select DMA_SHARED_BUFFER
	help
	  This implements a generic interface towards a Trusted Execution
	  Environment (TEE).

config TEE_3_2
        bool "Trusted Execution Environment support optee 3.2 exclusive of optee 1.0.1 "
        default n
        select OPTEE
        select TEE_2_4
        select GENERIC_ALLOCATOR
        select DMA_SHARED_BUFFER
        help
          This implements a generic interface towards a Trusted Execution
          Environment (TEE).

if TEE_2_4

menu "TEE drivers"

source "drivers/tee/optee/Kconfig"

endmenu

endif
```

## apollo/linux_core/mstar_repo/misdk/linuxkernel/4.9/drivers/xiaomi/Kconfig
```kconfig
#
# Xiaomi driver configuration
#
menu "Xiaomi Device Drivers"

source "drivers/xiaomi/hw_version/Kconfig"

endmenu
```

## apollo/linux_core/mstar_repo/misdk/linuxkernel/4.9/drivers/xiaomi/hw_version/Kconfig
```kconfig
config XIAOMI_HW_VERSION
	bool "For get the hardware verison of MiTV "
	default Y
	help
	  Say Y here for always.
```

## drivers/amlogic/bluetooth/Kconfig
```kconfig
config AMLOGIC_BT_DEVICE
    bool "BT Device support"
    depends on BT && RFKILL
    default n
    ---help---
      Say Y here if you want to use the BT device.

config BT_WAKE_CONTROL
	bool "Bt wake control support"
	depends on BT
	default n
    ---help---
      Say Y here if you want to use bt wake control.
```

## kernel/arch/arm/configs/bifrost_defconfig
```kconfig
CONFIG_ARM_CRYPTO=y
CONFIG_CRYPTO_SHA1_ARM_CE=y
CONFIG_CRYPTO_SHA2_ARM_CE=y
CONFIG_CRYPTO_AES_ARM=y
CONFIG_CRYPTO_AES_ARM_BS=y
CONFIG_CRYPTO_AES_ARM_CE=y
CONFIG_CRYPTO_GHASH_ARM_CE=y
CONFIG_CRYPTO_TEST=m
# CONFIG_CRYPTO_MANAGER_DISABLE_TESTS is not set
CONFIG_KERNEL_MODE_NEON=y
CONFIG_MP_ARMCE_TEST=y
```

## kernel/arch/arm/plat-mstar/Kconfig
```kconfig
menu "Mstar platform type"
	depends on ARCH_MSTAR

config ARCH_MSTAR_CA9
	bool "Mstar Cortex-A9 tile"
	select CPU_V7
	select ARM_GIC
	select MIGHT_HAVE_CACHE_L2X0
	select HAVE_PATA_PLATFORM
	select HAVE_ARM_TWD if LOCAL_TIMERS
	select HAVE_ARM_SCU if SMP

config ARCH_MSTAR_CA7
	bool "Mstar Cortex-A7 tile"
	select CPU_V7
	select ARM_GIC
	select HAVE_PATA_PLATFORM
	select HAVE_ARM_TWD if LOCAL_TIMERS
	select HAVE_ARM_SCU if SMP
	select MP_CA7_QUAD_CORE_PATCH

config ARCH_MSTAR_CA12
	bool "Mstar Cortex-A12 tile"
	select CPU_V7
	select ARM_GIC
	select HAVE_PATA_PLATFORM
	select HAVE_ARM_TWD if LOCAL_TIMERS
	select HAVE_ARM_SCU if SMP
endmenu

if PLAT_MSTAR

config PLAT_MSTAR_SCHED_CLOCK
	def_bool y if !ARCH_INTEGRATOR_AP
	select NEED_MACH_MEMORY_H
	select NEED_MACH_IO_H
	select HAVE_SCHED_CLOCK
endif
```

## kernel/arch/arm64/configs/bifrost_defconfig
```kconfig
CONFIG_ARM64_CRYPTO=y
CONFIG_CRYPTO_SHA1_ARM64_CE=y
CONFIG_CRYPTO_SHA2_ARM64_CE=y
CONFIG_CRYPTO_GHASH_ARM64_CE=y
CONFIG_CRYPTO_AES_ARM64_CE=y
CONFIG_CRYPTO_AES_ARM64_CE_CCM=y
CONFIG_CRYPTO_AES_ARM64_CE_BLK=y
CONFIG_CRYPTO_AES_ARM64_NEON_BLK=y
CONFIG_CRYPTO_TEST=m
# CONFIG_CRYPTO_MANAGER_DISABLE_TESTS is not set
CONFIG_KERNEL_MODE_NEON=y
CONFIG_MP_ARMCE_TEST=y
```
