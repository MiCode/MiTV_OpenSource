## kernel/drivers/xiaomi/Kconfig
```kconfig
#
# Xiaomi driver configuration
#
menu "Xiaomi Device Drivers"

source "drivers/xiaomi/hw_version/Kconfig"
source "drivers/xiaomi/mi_notifier/Kconfig"

endmenu
```

## kernel/drivers/xiaomi/hw_version/Kconfig
```kconfig
config XIAOMI_HW_VERSION
	bool "For get the hardware verison of MiTV "
	default N
	help
	  Say Y here if you need.
```

## kernel/drivers/xiaomi/mi_notifier/Kconfig
```kconfig
config XIAOMI_NOTIFIER
	bool "For notify some event between different driver"
	default N
	help
	  Say Y here if you need.
```
