/dts-v1/;
/plugin/;
/include/ "overlay_avb_SysAsRoot.dtsi"

&switch_gpio {
	switch-gpio = <66>;
};

&gpio_wifi_ctl {
	wifi-ctl-gpio = <45>;
};

&soc_m7332_sdio {
	cd-option = <0x1>, <0x322D>, <0x64>, <0x04>;
};
