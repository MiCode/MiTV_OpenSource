#include "../../../../drivers/mstar2/hal/m7642/gpio/mhal_gpio_reg.h"
/dts-v1/;

/ {
	model = "M7642";
	compatible = "arm,foundation-arm", "arm,m7642";
	interrupt-parent = <0x1>;
	#address-cells = <0x2>;
	#size-cells = <0x2>;

	chosen {
		bootargs = "root=/dev/mmcblk0p4 rootfstype=ext4 rw rootwait init=/sbin/init ip=dhcp console=ttyS0,115200,LX_MEM=0x02000000";
	};

	cpus {
		#address-cells = <0x1>;
		#size-cells = <0x0>;

		cpu-map {
			cluster0: cluster0 {
				core0 {
					cpu = <&cpu0>;
				};
				core1 {
					cpu = <&cpu1>;
				};
				core2 {
					cpu = <&cpu2>;
				};
				core3 {
					cpu = <&cpu3>;
				};
			};
		};

		cpu0: cpu@0 {
			#address-cells = <0x1>;
			device_type = "cpu";
			compatible = "arm,armv8";
			reg = <0>;
			enable-method = "psci";
			cpu-release-addr = <0x100510>;
		};

		cpu1: cpu@1 {
			device_type = "cpu";
			compatible = "arm,armv8";
			reg = <1>;
			enable-method = "psci";
			cpu-release-addr = <0x100510>;
		};
		cpu2: cpu@2 {
			device_type = "cpu";
			compatible = "arm,armv8";
			reg = <2>;
			enable-method = "psci";
			cpu-release-addr = <0x100510>;
		};

		cpu3: cpu@3 {
			device_type = "cpu";
			compatible = "arm,armv8";
			reg = <3>;
			enable-method = "psci";
			cpu-release-addr = <0x100510>;
		};

	};

        psci {
                compatible = "arm,psci";
                method = "smc";
                cpu_suspend = <0x84000001>;
                cpu_off = <0x84000002>;
                cpu_on = <0x84000003>;
        };

	memory@20200000 {
		device_type = "memory";
		reg = <0x0 0x20200000 0x0 0x1f400000>;
	};

	memory@38C00000 {
		device_type = "memory";
		reg = <0x0 0x4dc00000 0x0 0x8a00000>;
	};

	memory@A0000000 {
		device_type = "memory";
		reg = <0x0 0xb2a00000 0x0 0x2d600000>;
	};

	interrupt-controller@16001000 {
		compatible = "arm,cortex-a15-gic", "arm,cortex-a9-gic";
		#interrupt-cells = <0x3>;
		#address-cells = <0x0>;
		interrupt-controller;
		reg = <0x0 0x16001000 0x0 0x1000 0x0 0x16002000 0x0 0x4000>;
		interrupts = <0x1 0x9 0xf04>;
		linux,phandle = <0x1>;
		phandle = <0x1>;
	};

	mtk_mdla: mdla {
		  compatible = "mtk,mdla";
		  reg =   <0x0 0x1f3e8000 0x0 0x1000>,
		      <0x0 0x1f3e9000 0x0 0x1000>,
		      <0x0 0x1f3ea000 0x0 0x1000>,
		      <0x0 0x1fe00000 0x0 0x80000>;
		  interrupts = <0x0 0xbc 0x4>;
	};

	mtk_edmc: edmc@1078c000 {
		  compatible = "mtk,edmc";
		  reg = <0x0 0x1f3ec000 0x0 0x1000>;
		  interrupts = <0x0 0xbe 0x4>;
	};

	uart0 {
		compatible = "mstar8250-uart";
		interrupts = <0x0 0x0 0x4>;
	};

	pm_sleep_int {
		compatible = "pm_sleep_int";
		interrupts = <0x0 0x1 0x4>;
	};

	irq_vd_evd_r22hi {
		compatible = "irq_vd_evd_r22hi";
		interrupts = <0x0 0x2 0x4>;
	};

	mvd_int {
		compatible = "mvd_int";
		interrupts = <0x0 0x3 0x4>;
	};

	ps_int {
		compatible = "ps_int";
		interrupts = <0x0 0x4 0x4>;
	};

	nfie_int {
		compatible = "nfie_int";
		interrupts = <0x0 0x5 0x4>;
	};

	usb_int {
		compatible = "usb_int";
		interrupts = <0x0 0x6 0x4>;
	};

	uhc_int {
		compatible = "uhc_int";
		interrupts = <0x0 0x7 0x4>;
	};

	lpll_intr {
		compatible = "lpll_intr";
		interrupts = <0x0 0x8 0x4>;
	};

	emac_int {
		compatible = "emac_int";
		interrupts = <0x0 0x9 0x4>;
	};

	disp_be_int {
		compatible = "disp_be_int";
		interrupts = <0x0 0xa 0x4>;
	};

	mspi_int {
		compatible = "mspi_int";
		interrupts = <0x0 0xb 0x4>;
	};

	ge_int {
		compatible = "ge_int";
		interrupts = <0x0 0xc 0x4>;
	};

	evd_int {
		compatible = "evd_int";
		interrupts = <0x0 0xd 0x4>;
	};

	comb_int {
		compatible = "comb_int";
		interrupts = <0x0 0xe 0x4>;
	};

	mod_detect_intr {
		compatible = "mod_detect_intr";
		interrupts = <0x0 0xf 0x4>;
	};

	tsp2hk_int {
		compatible = "tsp2hk_int";
		interrupts = <0x0 0x10 0x4>;
	};

	cec_int_pm {
		compatible = "cec_int_pm";
		interrupts = <0x0 0x11 0x4>;
	};

	disp_fe_int {
		compatible = "disp_fe_int";
		interrupts = <0x0 0x12 0x4>;
	};

	dc_int {
		compatible = "dc_int";
		interrupts = <0x0 0x13 0x4>;
	};

	gop_int {
		compatible = "gop_int";
		interrupts = <0x0 0x14 0x4>;
	};

	scdc_int_pm {
		compatible = "scdc_int_pm";
		interrupts = <0x0 0x15 0x4>;
	};

	otg_int {
		compatible = "otg_int";
		interrupts = <0x0 0x16 0x4>;
	};

	d2b_int {
		compatible = "d2b_int";
		interrupts = <0x0 0x17 0x4>;
	};

	AUDMA_V2_INTR {
		compatible = "AUDMA_V2_INTR";
		interrupts = <0x0 0x18 0x4>;
	};
/*
	1'b0 {
		compatible = "1'b0";
		interrupts = <0x0 0x19 0x4>;
	};
*/
	emmc_osp_int {
		compatible = "emmc_osp_int";
		interrupts = <0x0 0x1a 0x4>;
	};

	scm_int {
		compatible = "scm_int";
		interrupts = <0x0 0x1b 0x4>;
	};

	vbi_int {
		compatible = "vbi_int";
		interrupts = <0x0 0x1c 0x4>;
	};

	mvd2mips_int {
		compatible = "mvd2mips_int";
		interrupts = <0x0 0x1d 0x4>;
	};

	gpd_int {
		compatible = "gpd_int";
		interrupts = <0x0 0x1e 0x4>;
	};

	tso_int {
		compatible = "tso_int";
		interrupts = <0x0 0x1f 0x4>;
	};

	hvd_int {
		compatible = "hvd_int";
		interrupts = <0x0 0x20 0x4>;
	};

	usb_int1 {
		compatible = "usb_int1";
		interrupts = <0x0 0x21 0x4>;
	};

	miu_int {
		compatible = "miu_int";
		interrupts = <0x0 0x22 0x4>;
	};

	error_resp_int {
		compatible = "error_resp_int";
		interrupts = <0x0 0x23 0x4>;
	};

	usb_int2 {
		compatible = "usb_int2";
		interrupts = <0x0 0x24 0x4>;
	};

	rtc2_int {
		compatible = "rtc2_int";
		interrupts = <0x0 0x25 0x4>;
	};

	aesdma_s_int {
		compatible = "aesdma_s_int";
		interrupts = <0x0 0x26 0x4>;
	};

	int_uart1 {
		compatible = "int_uart1";
		interrupts = <0x0 0x27 0x4>;
	};

	disp_mfdec_int {
		compatible = "disp_mfdec_int";
		interrupts = <0x0 0x28 0x4>;
	};

	mspi_cilink_int {
		compatible = "mspi_cilink_int";
		interrupts = <0x0 0x29 0x4>;
	};

	miu_security_int {
		compatible = "miu_security_int";
		interrupts = <0x0 0x2a 0x4>;
	};

	dipw_INT {
		compatible = "dipw_INT";
		interrupts = <0x0 0x2b 0x4>;
	};

	miic2_int {
		compatible = "miic2_int";
		interrupts = <0x0 0x2c 0x4>;
	};

	jpd_int {
		compatible = "jpd_int";
		interrupts = <0x0 0x2d 0x4>;
	};

	pm_irq_out {
		compatible = "pm_irq_out";
		interrupts = <0x0 0x2e 0x4>;
	};

	pka_all_int {
		compatible = "pka_all_int";
		interrupts = <0x0 0x2f 0x4>;
	};

	int_bdma_merge {
		compatible = "int_bdma_merge";
		interrupts = <0x0 0x30 0x4>;
	};

	PAS_PTS_INTRL_COMBINE {
		compatible = "PAS_PTS_INTRL_COMBINE";
		interrupts = <0x0 0x31 0x4>;
	};

	uart2mcu_intr {
		compatible = "uart2mcu_intr";
		interrupts = <0x0 0x32 0x4>;
	};

	urdma2mcu_intr {
		compatible = "urdma2mcu_intr";
		interrupts = <0x0 0x33 0x4>;
	};

	dvi_hdmi_hdcp_int {
		compatible = "dvi_hdmi_hdcp_int";
		interrupts = <0x0 0x34 0x4>;
	};

	g3d2mcu_irq_dft {
		compatible = "g3d2mcu_irq_dft";
		interrupts = <0x0 0x35 0x4>;
	};

	fcie_tee_int {
		compatible = "fcie_tee_int";
		interrupts = <0x0 0x36 0x4>;
	};

	smart_int {
		compatible = "smart_int";
		interrupts = <0x0 0x37 0x4>;
	};

	hdcp_x74_int {
		compatible = "hdcp_x74_int";
		interrupts = <0x0 0x38 0x4>;
	};

	wadr_err_int {
		compatible = "wadr_err_int";
		interrupts = <0x0 0x39 0x4>;
	};

	ve_int {
		compatible = "ve_int";
		interrupts = <0x0 0x3a 0x4>;
	};

	sdio_int {
		compatible = "sdio_int";
		interrupts = <0x0 0x3b 0x4>;
	};

	acpu_int {
		compatible = "acpu_int";
		interrupts = <0x0 0x3c 0x4>;
	};

	miic1_int {
		compatible = "miic1_int";
		interrupts = <0x0 0x3d 0x4>;
	};

	usb_int3 {
		compatible = "usb_int3";
		interrupts = <0x0 0x3e 0x4>;
	};

	miic0_int {
		compatible = "miic0_int";
		interrupts = <0x0 0x3f 0x4>;
	};

	int_timer0 {
		compatible = "int_timer0";
		interrupts = <0x0 0x40 0x4>;
	};

	int_timer1 {
		compatible = "int_timer1";
		interrupts = <0x0 0x41 0x4>;
	};

	int_wdt {
		compatible = "int_wdt";
		interrupts = <0x0 0x42 0x4>;
	};

	usb_int_merge3 {
		compatible = "usb_int_merge3";
		interrupts = <0x0 0x43 0x4>;
	};

	AU_SPDIF_TX_CS_INT0 {
		compatible = "AU_SPDIF_TX_CS_INT0";
		interrupts = <0x0 0x44 0x4>;
	};

	AU_SPDIF_TX_CS_INT1 {
		compatible = "AU_SPDIF_TX_CS_INT1";
		interrupts = <0x0 0x45 0x4>;
	};

	MB_DSP2toMCU_INT0 {
		compatible = "MB_DSP2toMCU_INT0";
		interrupts = <0x0 0x46 0x4>;
	};

	MB_DSP2toMCU_INT1 {
		compatible = "MB_DSP2toMCU_INT1";
		interrupts = <0x0 0x47 0x4>;
	};

	usb_int_fiq {
		compatible = "usb_int_fiq";
		interrupts = <0x0 0x48 0x4>;
	};

	uhc_int_fiq {
		compatible = "uhc_int_fiq";
		interrupts = <0x0 0x49 0x4>;
	};

	ve_done_TT_irq {
		compatible = "ve_done_TT_irq";
		interrupts = <0x0 0x4a 0x4>;
	};

	HDMI_NON_PCM_MODE_INT_OUT {
		compatible = "HDMI_NON_PCM_MODE_INT_OUT";
		interrupts = <0x0 0x4b 0x4>;
	};

	SPDIF_IN_NON_PCM_INT_OUT {
		compatible = "SPDIF_IN_NON_PCM_INT_OUT";
		interrupts = <0x0 0x4c 0x4>;
	};

	lan_esd_int {
		compatible = "lan_esd_int";
		interrupts = <0x0 0x4d 0x4>;
	};

	SE_DSP2UP_intr {
		compatible = "SE_DSP2UP_intr";
		interrupts = <0x0 0x4e 0x4>;
	};

	tsp2aeon_int {
		compatible = "tsp2aeon_int";
		interrupts = <0x0 0x4f 0x4>;
	};

	vivaldi_str_intr {
		compatible = "vivaldi_str_intr";
		interrupts = <0x0 0x50 0x4>;
	};

	vivaldi_pts_intr {
		compatible = "vivaldi_pts_intr";
		interrupts = <0x0 0x51 0x4>;
	};

	DSP_MIU_PROT_intr {
		compatible = "DSP_MIU_PROT_intr";
		interrupts = <0x0 0x52 0x4>;
	};

	xiu_timeout_int {
		compatible = "xiu_timeout_int";
		interrupts = <0x0 0x53 0x4>;
	};

	dmdmcu2hk_int {
		compatible = "dmdmcu2hk_int";
		interrupts = <0x0 0x54 0x4>;
	};

	ir_in {
		compatible = "ir_in";
		interrupts = <0x0 0x55 0x4>;
	};

	imi_top_irq {
		compatible = "imi_top_irq";
		interrupts = <0x0 0x56 0x4>;
	};

	vdmcu2hk_int {
		compatible = "vdmcu2hk_int";
		interrupts = <0x0 0x57 0x4>;
	};

	ldm_dma_done_int0 {
		compatible = "ldm_dma_done_int0";
		interrupts = <0x0 0x58 0x4>;
	};

	ldm_dma_done_int1 {
		compatible = "ldm_dma_done_int1";
		interrupts = <0x0 0x59 0x4>;
	};

	PM_SD_CDZ_int {
		compatible = "PM_SD_CDZ_int";
		interrupts = <0x0 0x5a 0x4>;
	};

	MB_auR2toMCU_INT0 {
		compatible = "MB_auR2toMCU_INT0";
		interrupts = <0x0 0x5b 0x4>;
	};

	AFEC_VSYNC {
		compatible = "AFEC_VSYNC";
		interrupts = <0x0 0x5c 0x4>;
	};

	MB_auR2toMCU_INT1 {
		compatible = "MB_auR2toMCU_INT1";
		interrupts = <0x0 0x5d 0x4>;
	};

	MB_auR2toMCU_INT2 {
		compatible = "MB_auR2toMCU_INT2";
		interrupts = <0x0 0x5e 0x4>;
	};

	DSP2MIPS_INT {
		compatible = "DSP2MIPS_INT";
		interrupts = <0x0 0x5f 0x4>;
	};

	MB_auR2toMCU_INT3 {
		compatible = "MB_auR2toMCU_INT3";
		interrupts = <0x0 0x60 0x4>;
	};

	AU_DMA_BUFFER_INT_EDGE {
		compatible = "AU_DMA_BUFFER_INT_EDGE";
		interrupts = <0x0 0x61 0x4>;
	};

	int_all {
		compatible = "int_all";
		interrupts = <0x0 0x62 0x4>;
	};

	PM_SD_CDZ1_int {
		compatible = "PM_SD_CDZ1_int";
		interrupts = <0x0 0x63 0x4>;
	};

	reg_hst0to3_int {
		compatible = "reg_hst0to3_int";
		interrupts = <0x0 0x64 0x4>;
	};

	reg_hst0to2_int {
		compatible = "reg_hst0to2_int";
		interrupts = <0x0 0x65 0x4>;
	};

	reg_hst0to1_int {
		compatible = "reg_hst0to1_int";
		interrupts = <0x0 0x66 0x4>;
	};

	ext_gpio_int0 {
		compatible = "ext_gpio_int0";
		interrupts = <0x0 0x67 0x4>;
	};

	reg_hst1to3_int {
		compatible = "reg_hst1to3_int";
		interrupts = <0x0 0x68 0x4>;
	};

	emac_man_int {
		compatible = "emac_man_int";
		interrupts = <0x0 0x69 0x4>;
	};

	reg_hst1to0_int {
		compatible = "reg_hst1to0_int";
		interrupts = <0x0 0x6a 0x4>;
	};

	ext_gpio_int1 {
		compatible = "ext_gpio_int1";
		interrupts = <0x0 0x6b 0x4>;
	};

	reg_hst2to3_int {
		compatible = "reg_hst2to3_int";
		interrupts = <0x0 0x6c 0x4>;
	};

	int_timer2 {
		compatible = "int_timer2";
		interrupts = <0x0 0x6d 0x4>;
	};

	reg_hst2to0_int {
		compatible = "reg_hst2to0_int";
		interrupts = <0x0 0x6e 0x4>;
	};

	ext_gpio_int2 {
		compatible = "ext_gpio_int2";
		interrupts = <0x0 0x6f 0x4>;
	};

	reg_hst3to2_int {
		compatible = "reg_hst3to2_int";
		interrupts = <0x0 0x70 0x4>;
	};

	reg_hst3to1_int {
		compatible = "reg_hst3to1_int";
		interrupts = <0x0 0x71 0x4>;
	};

	reg_hst3to0_int {
		compatible = "reg_hst3to0_int";
		interrupts = <0x0 0x72 0x4>;
	};

	usb_int_merge1 {
		compatible = "usb_int_merge1";
		interrupts = <0x0 0x73 0x4>;
	};

	ve_vbi_f0_int {
		compatible = "ve_vbi_f0_int";
		interrupts = <0x0 0x74 0x4>;
	};

	usb_int_merge2 {
		compatible = "usb_int_merge2";
		interrupts = <0x0 0x75 0x4>;
	};

	ve_vbi_f1_int {
		compatible = "ve_vbi_f1_int";
		interrupts = <0x0 0x76 0x4>;
	};

	ext_gpio_int3 {
		compatible = "ext_gpio_int3";
		interrupts = <0x0 0x77 0x4>;
	};

	ext_gpio_int4 {
		compatible = "ext_gpio_int4";
		interrupts = <0x0 0x78 0x4>;
	};

	ext_gpio_int5 {
		compatible = "ext_gpio_int5";
		interrupts = <0x0 0x79 0x4>;
	};

	ext_gpio_int6 {
		compatible = "ext_gpio_int6";
		interrupts = <0x0 0x7a 0x4>;
	};

	pwm_rp_l_int {
		compatible = "pwm_rp_l_int";
		interrupts = <0x0 0x7b 0x4>;
	};

	pwm_fp_l_int {
		compatible = "pwm_fp_l_int";
		interrupts = <0x0 0x7c 0x4>;
	};

	pwm_rp_r_int {
		compatible = "pwm_rp_r_int";
		interrupts = <0x0 0x7d 0x4>;
	};

	pwm_fp_r_int {
		compatible = "pwm_fp_r_int";
		interrupts = <0x0 0x7e 0x4>;
	};

	ext_gpio_int7 {
		compatible = "ext_gpio_int7";
		interrupts = <0x0 0x7f 0x4>;
	};

	miic3_int {
		compatible = "miic3_int";
		interrupts = <0x0 0xa6 0x4>;
	};

	usc_int1 {
		compatible = "usc_int1";
		interrupts = <0x0 0xa7 0x4>;
	};

	uhb_int1 {
		compatible = "uhb_int1";
		interrupts = <0x0 0xa8 0x4>;
	};

	int_uart2 {
		compatible = "int_uart2";
		interrupts = <0x0 0xa9 0x4>;
	};

	blkprearb_auto_bist_int {
		compatible = "blkprearb_auto_bist_int";
		interrupts = <0x0 0xaa 0x4>;
	};

	int_uart4 {
		compatible = "int_uart4";
		interrupts = <0x0 0xab 0x4>;
	};

	mfe_int {
		compatible = "mfe_int";
		interrupts = <0x0 0xac 0x4>;
	};

	cmdq_int {
		compatible = "cmdq_int";
		interrupts = <0x0 0xad 0x4>;
	};

	pcm2mcu_int {
		compatible = "pcm2mcu_int";
		interrupts = <0x0 0xae 0x4>;
	};

	sc_hk_int {
		compatible = "sc_hk_int";
		interrupts = <0x0 0xaf 0x4>;
	};

	earc_tx_int {
		compatible = "earc_tx_int";
		interrupts = <0x0 0xb0 0x4>;
	};

	ci_gpio_int {
		compatible = "ci_gpio_int";
		interrupts = <0x0 0xb1 0x4>;
	};

	cilink_soc_if {
		compatible = "cilink_soc_if";
		interrupts = <0x0 0xb2 0x4>;
	};

	tsp_fi_queue_int {
		compatible = "tsp_fi_queue_int";
		interrupts = <0x0 0xb3 0x4>;
	};

	tsen_0_ov_irq {
		compatible = "tsen_0_ov_irq";
		interrupts = <0x0 0xb4 0x4>;
	};

	tsen_1_ov_irq {
		compatible = "tsen_1_ov_irq";
		interrupts = <0x0 0xb5 0x4>;
	};

	frc_irq {
		compatible = "frc_irq";
		interrupts = <0x0 0xb6 0x4>;
	};

	fsp_demura_irq {
		compatible = "fsp_demura_irq";
		interrupts = <0x0 0xb7 0x4>;
	};

	lzma_irq {
		compatible = "lzma_irq";
		interrupts = <0x0 0xb8 0x4>;
	};

/*
	1'b0 {
		compatible = "1'b0";
		interrupts = <0x0 0xb9 0x4>;
	};
*/

	adcpll_irq {
		compatible = "adcpll_irq";
		interrupts = <0x0 0xba 0x4>;
	};

	dc_sub_int {
		compatible = "dc_sub_int";
		interrupts = <0x0 0xbb 0x4>;
	};

	aia_mdla_ns_int {
		compatible = "aia_mdla_ns_int";
		interrupts = <0x0 0xbc 0x4>;
	};

	aia_conn_int {
		compatible = "aia_conn_int";
		interrupts = <0x0 0xbd 0x4>;
	};

	aia_dmac_int {
		compatible = "aia_dmac_int";
		interrupts = <0x0 0xbe 0x4>;
	};

	aia_sec_int {
		compatible = "aia_sec_int";
		interrupts = <0x0 0xbf 0x4>;
	};

	aia_mdla_s_int {
		compatible = "aia_mdla_s_int";
		interrupts = <0x0 0xc0 0x4>;
	};

	dip2_int {
		compatible = "dip2_int";
		interrupts = <0x0 0xc1 0x4>;
	};

	dip2_sec_int {
		compatible = "dip2_sec_int";
		interrupts = <0x0 0xc2 0x4>;
	};

	timer {
		compatible = "arm,mstar-timer-workaround","arm,armv8-timer";
		interrupts = <0x1 0xd 0xff01 0x1 0xe 0xff01 0x1 0xb 0xff01 0x1 0xa 0xff01>;
		clock-frequency = <0xb71b00>;
	};

	pmu {
		compatible = "arm,cortex-a15-pmu";
		interrupts = <0x0 0x86 0x4>,
			     <0x0 0x88 0x4>,
			     <0x0 0x8a 0x4>,
			     <0x0 0x8c 0x4>;
	};

	emac {
		compatible = "mstar-emac";
	};

    miu {
        compatible = "mstar-miu";
    };

        ir {
	        compatible = "mstar-ir";
	};

	mbx {
	        compatible = "mstar-mbx";
	};

	xc {
		compatible = "mstar-xc";
	};

	scaler {
		compatible = "mstar-scaler";
	};

	gflip {
		compatible = "mstar-gflip";
	};

	alsa {
		compatible = "Mstar-alsa";
	};

	mstar-rtc@0 {
		compatible = "mstar-rtc";
		index = <0>;
		xtal = <12000000>;
		freq = <1>;
	};

	mstar-frc-r2 {
		compatible = "FRC-R2";
	};

	Mstar-ehci-1 {
		compatible = "Mstar-ehci-1";
	};

	Mstar-ehci-2 {
		compatible = "Mstar-ehci-2";
	};

	Mstar-ehci-3 {
		compatible = "Mstar-ehci-3";
	};

	Mstar-ehci-4 {
		compatible = "Mstar-ehci-4";
	};

	Mstar-lp-standby {
		compatible = "Mstar-lp-standby";
	};

	Mstar-udc {
		compatible = "Mstar-udc";
		interrupts = <0x0 0x16 0x0>;
	};

	Mstar-otg {
		compatible = "Mstar-otg";
		interrupts = <0x0 0x06 0x0>, <0x0 0x07 0x0>;
	};

        Mstar-utopia2k-str {
                compatible = "Mstar-utopia2k-str";
                mhl {
                        resume {
                                stage0 {
                                        pre-condition = "hdmi_rx";
                                };
                        };
                };
                hdmi_rx {
                        resume {
                                stage0 {
                                        pre-condition = "hdmi_earc";
                                        post-condition = "hdmi_rx";
                                };
                        };
                };
                hdmi_earc {
                        resume {
                                stage0 {
                                        post-condition = "hdmi_earc";
                                };
                        };
                };
                avd {
                        resume {
                                stage0 {
                                        pre-condition = "vif";
                                        post-condition = "avd";
                                };
                        };
                };
                vif {
                        resume {
                                stage0 {
                                        post-condition = "vif";
                                };
                        };
                };
                vdec {
                        resume {
                                stage0 {
                                        post-condition = "vdec";
                                };
                        };
                };

                pq {
                        suspend {
                                stage0 {
                                        post-condition = "pq";
                                };
                        };
                        resume {
                                stage0 {
                                        post-condition = "pq";
                                        pre-condition = "xc";
                                };
                        };
                };

                miu {
                        resume {
                                stage0 {
                                        post-condition = "miu";
                                };
                        };
                };

                mvop {
                        resume {
                                stage0 {
                                        post-condition = "mvop";
                                };
                        };
                };

                pnl {
                        suspend {
                                stage0 {
                                        pre-condition = "xc";
                                };
                        };
                        resume {
                                stage0 {
                                        post-condition = "pnl";
                                };
                        };
                };

                ace {
                        suspend {
                                stage0 {
                                        post-condition = "ace";
                                };
                        };
                        resume {
                                stage0 {
                                        post-condition = "ace";
                                        pre-condition = "xc";
                                };
                        };
                };

                ve {
                        resume {
                                stage0 {
                                        pre-condition = "miu","xc";
                                };
                        };
                };

                xc {
                        suspend {
                                stage0 {
                                        pre-condition = "pq","ace";
                                        post-condition = "xc";
                                };
                        };
                        resume {
                                stage0 {
                                        pre-condition = "vdec","avd","miu","mvop","pnl";
                                        post-condition = "xc";
                                };
                        };
                };
	            dmx {
		          suspend {
		        	stage0 {
		        	  pre-condition = "dscmb";
		              post-condition = "dmx";
		        	};
		          };
		          resume {
		            stage0 {
		        	pre-condition = "dscmb";
		            post-condition = "dmx";
		            };
		          };
	            };
                
		        dscmb {
		          suspend {
		        	stage0 {
		        	  post-condition = "dscmb";
		        	};
		          };
		          resume {
		        	stage0 {
		        	  post-condition = "dscmb";
		        	};
		          };
		        };

			gop {
				resume {
					stage0 {
						pre-condition = "pnl","xc";
						post-condition = "gop";
					};
				};
			};
        };

	Mstar-sys {
		firmware {
			audio {
				path = "/vendor/lib/utopia/audio_bin/";
			};
			vdec_fw {
				path = "/vendor/lib/utopia/vdec_bin/";
			};
		};
	};

        Mstar-STR {
                mstar_mci {
                        suspend-stage1 = "late";
                        resume-stage1 = "early";
                        policy = "async";
                };

                mmcblk {
                        suspend-stage1 = "noirq";
                        resume-stage1 = "noirq";
                };

                mmcbus {
                        suspend-stage1 = "late";
                        resume-stage1 = "early";
                };

                Mstar-mbx {
                        suspend-stage1 = "noirq";
                        resume-stage1 = "noirq";
                };

		mstar-xc {
			suspend-stage1 = "noirq";
			resume-stage1 = "noirq";
		};

                Mstar-utopia2k-str {
                        suspend-stage1 = "late";
                        resume-stage1 = "early";
                        policy = "async";
                        resume-stage1-waitfor = "mstar_mci.0";
                };
        };

	firmware {
                optee {
                        compatible = "linaro,optee-tz";
                        method = "smc";
                };

                android {
			compatible = "android,firmware";
			hardware ="m7642";
			revision ="0001";
			Serial   ="0000000000000000";
			Processor ="AArch32 Processor rev 3 (aarch32)";
			mode ="20170621";
			baseband ="20170621";
			bootloader ="20170621";
		};
	};

	/* example of consume a gpio pin with mapped irq
	foo{
		interrupt-parent = <&gpio>;
		interrupts = <0 LEVEL_HIGH>;
	}
	*/

	gpio: gpio {
		compatible = "mstar,gpio";
		gpio-controller;
		#gpio-cells = <1>;
		interrupt-controller;
		skip-save-status = <6 44>;
		#interrupt-cells = <2>; /* cell name GPIO_PAD, trigger-type*/
	};

	switch_gpio {
		compatible = "mstar,switch-gpio";
		switch-name = "h2w";
		switch-gpio = <66>;
		switch-inverse = <0>;
	};

	gpio_wifi_ctl {
		compatible = "mstar,gpio-wifi-ctl";
		wifi-ctl-gpio = <17>;
	};

	backlight {
		compatible = "backlight";
		brightness-levels = <0 255>;
		default-brightness-level = <255>;
		bl_ctrl = <6>;
		bl_ctrl_inverse = <0>;
		vcc_gpio = <44>;
		vcc_gpio_invert = <0>;
		/* led-pwm-control-support; */
		/* led-pwm-control-channel = <0>; */
		/* led-pwm-control-resume-period = <0xb71a>; */
		/* led-pwm-control-resume-duty = <0xb71a>; */
		/* led-pwm-control-resume-div = <0xff>; */
		/* led-pwm-control-resume-polarity = <0>; */
		/* led-pwm-control-suspend-period = <0xb71a>; */
		/* led-pwm-control-suspend-duty = <0xb71a>; */
		/* led-pwm-control-suspend-div = <0xff>; */
		/* led-pwm-control-suspend-polarity = <0>; */
	};

	i2c0: i2c@0 {
		compatible = "mstar,swi2c";
		iic-mode = <1>;	 /* i2c-mode: 0:swi2c; 1:hwi2c */
		bus-index = <0>;	/* swi2c setting: bus index */
		sda-gpio = <55>;	/* swi2c setting: sda pad */
		scl-gpio = <54>;	/* swi2c setting: scl pad */
		def-delay = <100>;  /* swi2c setting: clk */
		hw-port = <3>;	  /* hwi2c setting: port */
		pad-mux = <25>;	 /* hwi2c setting: pad mux */
		speed-khz = <100>;  /* hwi2c setting: clk */
		retries = <5>;	  /* Unused */
		status = "okay";	/* Unused */
	};

	i2c1: i2c@1 {
		compatible = "mstar,swi2c";
		iic-mode = <0>;	 /* i2c-mode: 0:swi2c; 1:hwi2c */
		bus-index = <1>;	/* swi2c setting: bus index */
		sda-gpio = <143>;   /* swi2c setting: sda pad */
		scl-gpio = <142>;   /* swi2c setting: scl pad */
		def-delay = <100>;  /* swi2c setting: clk */
		hw-port = <0>;	  /* hwi2c setting: port */
		pad-mux = <0>;	  /* hwi2c setting: pad mux */
		speed-khz = <100>;  /* hwi2c setting: clk */
		retries = <5>;	  /* Unused */
		status = "okay";	/* Unused */
	};

	mtk_sensor0: mtk-sensor@0 {
		compatible = "mtk-thermal";
		#thermal-sensor-cells = <1>;
	};

	thermal-zones {
		mtk_thermal: mtk-thermal {
			polling-delay = <1000>;
			polling-delay-passive = <100>;

			thermal-sensors = <&mtk_sensor0 0>;
			trips {
				threshold: trip-point@0 {
					temperature = <120000>;
					hysteresis = <1000>;
					type = "passive";
				};
				target: trip-point@1 {
					temperature = <130000>;
					hysteresis = <1000>;
					type = "passive";
				};
			};
			cooling-maps {
				 map0 {
					trip = <&target>;
					contribution = <1024>;
					cooling-device = <&cpu0 0xffffffff 0xffffffff>;
				};
			};
		};
	};

	mmc_host_sdio {
		compatible = "mstar, sdio";
		cd-option = <0x0>,<0x0000>,<0x00>,<0x00>;
		wp-option = <0>,<0>,<0>,<0>;
		pc-option =  <0>,<0>,<0>,<0>;
	};

	buf_tag {
	/* heaptype: HEAP_TYPE_IOMMU = 0, HEAP_TYPE_CMA= 1,  HEAP_TYPE_NON_MMA = 2*/
	/* miutype:  UMA_OR_MIU0 = 0, MIU_1 = 1 */
		mdla_buf {
			heaptype = <0>;
			max_size = <0x0 0xec00000>;
			miu = <0>;
		};
		vdec_fb {
			heaptype = <0>;
			max_size = <0x0 0x14300000>;
			miu = <0>;
		};
		vdec_es {
			heaptype = <0>;
			max_size = <0x0 0x03000000>;
			miu = <0>;
		};
		xc_main {
			heaptype = <0>;
			max_size = <0x0 0x5F00000>;
			miu = <0>;
		};
		xc_sub {
			heaptype = <0>;
			max_size = <0x0 0x1800000>;
			miu = <0>;
		};
		xc_hse {
			heaptype = <0>;
			max_size = <0x0 0x1000000>;
			miu = <0>;
		};
		mali_gop_dma {
			heaptype = <0>;
			max_size = <0x0 0x6000000>;
			normal_zone = <0>;
		};
		mali_gop {
			heaptype = <0>;
			max_size = <0x0 0x25800000>;
			normal_zone = <1>;
		};
		xc_frc_pq {
			heaptype = <0>;
			max_size = <0x0 0xf00000>;
			miu = <0>;
		};
		xc_frc_l {
			heaptype = <0>;
			max_size = <0x0 0x8200000>;
			miu = <0>;
		};
		img_frame {
			heaptype = <0>;
			max_size = <0x0 0x2000000>;
			miu = <0>;
		};
		mheg_write {
			heaptype = <0>;
			max_size = <0x0 0x2000000>;
			miu = <0>;
		};
		mheg_read {
			heaptype = <0>;
			max_size = <0x0 0x500000>;
			miu = <0>;
		};
		mheg_inter {
			heaptype = <0>;
			max_size = <0x0 0xD00000>;
			miu = <0>;
		};
		jpd_write {
			heaptype = <0>;
			max_size = <0x0 0x2000000>;
			miu = <0>;
		};
		jpd_read {
			heaptype = <0>;
			max_size = <0x0 0x500000>;
			miu = <0>;
		};
		jpd_inter {
			heaptype = <0>;
			max_size = <0x0 0xD00000>;
			miu = <0>;
		};
		disp_photo {
			heaptype = <0>;
			max_size = <0x0 0x4000000>;
			miu = <0>;
		};
		directfb_frame0 {
			heaptype = <0>;
			max_size = <0x0 0x8000000>;
			miu = <0>;
		};
		directfb_frame1 {
			heaptype = <0>;
			max_size = <0x0 0x1200000>;
			miu = <0>;
		};
		tsp_pvr {
			heaptype = <0>;
			max_size = <0x0 0x0D80000>;
			miu = <0>;
		};
        tsr_ginga {
             heaptype = <0>;
             max_size = <0x0 0x0800000>;
             miu = <0>;
         };
		tsp_filein {
			heaptype = <0>;
			max_size = <0x0 0x0240000>;
			miu = <0>;
		};
		tsp_fiq {
			heaptype = <0>;
			max_size = <0x0 0x402000>;
			miu = <0>;
		};
		tsp_alppvr {
			heaptype = <0>;
			max_size = <0x0 0x0C00000>;
			miu = <0>;
		};
		fbdev {
			heaptype = <0>;
			max_size = <0x0 0x4000000>;
			miu = <0>;
		};
                inject_filein {
                        heaptype = <0>;
                        max_size = <0x0 0x0200000>;
                        miu = <0>;
                        mmap_name = "MI_INJECT_BUF";
                };
                inject_secure {
                        heaptype = <0>;
                        max_size = <0x0 0x0200000>;
                        miu = <0>;
                        mmap_name = "E_MMAP_ID_OPTEE_MEM_EXT";
                };
		venc {
			heaptype = <0>;
			max_size = <0x0 0x01800000>;
			miu = <0>;
                };
	};

	soc-dvfs {
		enable =  <1>;
		package = <1>;
		cluster = <1>;
		cluster_0 {
			cpu-info {
				partid =    <0xd03>;
				mask   =    <0x0>;
				freqaddr =  <0x1F200A04>;
				anabank =   <0x110c00>;
				mcubank =   <0x101d00>;
			};
			table-info_0 {
				sys-info {
					default-clock = <1000>;
					min-clock =     <1000>;
					max-clock =     <1370>;
					boost-clock =   <1300>;
					antutu-clock =  <1370>;
					protect-clock = <800>;
					default-cpu =   <100>;
					default-core =  <100>;
					max-cpu =       <120>;
					min-cpu =       <90>;
				};
				temp-info {
					freeze_lower =  <0xff>;
					freeze_upper =  <0xff>;
					normal_lower =  <120>;
					normal_upper =  <135>;
					reset =         <150>;
					power-ss     =  <90>;
					power-ff     =  <90>;
				};
				core-info {
					min-clock =     <600>;
					max-clock =     <600>;
					power-ss =      <100>;
					power-ff =      <95>;
				};
				clock-info {
					level = <4>;
					pairs {
						setting_0 {
							min-clock = <1000>;
							max-clock = <1200>;
							power-ss =  <100>;
							power-ff =  <95>;
						};
						setting_1 {
							min-clock = <1200>;
							max-clock = <1300>;
							power-ss =  <110>;
							power-ff =  <105>;
						};
						setting_2 {
							min-clock = <1300>;
							max-clock = <1370>;
							power-ss =  <115>;
							power-ff =  <110>;
						};
						setting_3 {
							min-clock = <1370>;
							max-clock = <1371>;
							power-ss =  <120>;
							power-ff =  <115>;
						};
					};
				};
				power-info {
					type = "i2c";
					parm {
						set =       "hw";
						port =      <3>;
						slave-id =  <0x80>;
						id =        <0x9a>;
						shift =     <1>;
						step =      <3>;
					};
				};
			};
		};
    };
};
