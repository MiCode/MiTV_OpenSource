/dts-v1/;
/plugin/;
/include/ "overlay_avb_SysAsRoot.dtsi"
&i2c2 {
		iic-mode = <1>;     /* i2c-mode: 0:swi2c; 1:hwi2c */
		bus-index = <1>;    /* swi2c setting: bus index */
		sda-gpio = <82>;   /* swi2c setting: sda pad */
		scl-gpio = <81>;   /* swi2c setting: scl pad */
		def-delay = <100>;  /* swi2c setting: clk */
		hw-port = <0>;      /* hwi2c setting: port */
		pad-mux = <1>;      /* hwi2c setting: pad mux */
		speed-khz = <100>;  /* hwi2c setting: clk */
		retries = <5>;      /* Unused */
		status = "okay";    /* Unused */
	};
