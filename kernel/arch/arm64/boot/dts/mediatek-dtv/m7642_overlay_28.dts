/dts-v1/;
/plugin/;

&firmware {
	android {
		fstab {
			compatible = "android,fstab";
			vendor {
				compatible = "android,vendor";
				dev = "/dev/block/platform/mstar_mci.0/by-name/vendor";
				type = "ext4";
				mnt_flags = "ro";
				fsmgr_flags = "wait";
			};
		};
	};
};
