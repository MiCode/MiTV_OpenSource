/*
 * Copyright (c) 2019 MediaTek Inc.
 */

/ {
	/* The Platform */
	model = "M7332";
	compatible = "arm,foundation-aarch64", "arm,m7332";
	interrupt-parent = <&gic>;
	#address-cells = <2>;
	#size-cells = <2>;

	/* The CPU */
	cpus {
		#address-cells = <2>;
		#size-cells = <0>;

		cpu-map {
			cluster0: cluster0 {
				core0 {
					cpu = <&cpu0>;
				};
				core1 {
					cpu = <&cpu1>;
				};
				core2 {
					cpu = <&cpu2>;
				};
				core3 {
					cpu = <&cpu3>;
				};
			};
		};

		cpu0: cpu@0 {
			#cooling-cells = <0x2>;
			device_type = "cpu";
			compatible = "arm,cortex-a53", "arm,armv8";
			reg = <0x0 0x0>;
                        enable-method = "psci";
			cpu-release-addr = <0x0 0x00100510>;
		};
		cpu1: cpu@1 {
			device_type = "cpu";
			compatible = "arm,cortex-a53", "arm,armv8";
			reg = <0x0 0x01>;
                        enable-method = "psci";
			cpu-release-addr = <0x0 0x00100510>;
		};
		cpu2: cpu@2 {
                        device_type = "cpu";
                        compatible = "arm,cortex-a53", "arm,armv8";
                        reg = <0x0 0x02>;
                        enable-method = "psci";
                        cpu-release-addr = <0x0 0x00100510>;
                };
		cpu3: cpu@3 {
                        device_type = "cpu";
                        compatible = "arm,cortex-a53", "arm,armv8";
                        reg = <0x0 0x03>;
                        enable-method = "psci";
                        cpu-release-addr = <0x0 0x00100510>;
                };
	};

	psci {
		compatible = "arm,psci";
		method = "smc";
		cpu_suspend = <0x84000001>;
		cpu_off = <0x84000002>;
		cpu_on = <0x84000003>;
	};

	gic: interrupt-controller@16001000 {
		compatible = "arm,cortex-a15-gic", "arm,cortex-a9-gic";
		#interrupt-cells = <3>;
		#address-cells = <0>;
		interrupt-parent = <&gic>;
		interrupt-controller;
		reg = <0x0 0x16001000 0 0x1000>,
		      <0x0 0x16002000 0 0x4000>;
		interrupts = <1 9 0xf04>;
	};

	mtk_intc0: interrupt-controller@1f203200 {
		compatible = "mtk-intc";
		#interrupt-cells = <0x3>;
		interrupt-parent = <&gic>;
		interrupt-controller;
		reg =	<0x0 0x1f2032c0 0x0 0x80>;
		gic_spi = <32 64>;
	};

	mtk_intc1: interrupt-controller@1f203280 {
		compatible = "mtk-intc";
		#interrupt-cells = <0x3>;
		interrupt-parent = <&gic>;
		interrupt-controller;
		reg =	<0x0 0x1f203280 0x0 0x80>;
		gic_spi = <96 64>;
	};

	mtk_intc2: interrupt-controller@1f2020c0 {
		compatible = "mtk-intc";
		#interrupt-cells = <0x3>;
		interrupt-parent = <&gic>;
		interrupt-controller;
		reg =	<0x0 0x1f2020c0 0x0 0x80>;
		gic_spi = <198 28>;
	};

	mtk_intc3: interrupt-controller@1f202080 {
		compatible = "mtk-intc";
		#interrupt-cells = <0x3>;
		interrupt-parent = <&gic>;
		interrupt-controller;
		reg =	<0x0 0x1f202080 0x0 0x80>;
		gic_spi = <226 28>;
	};

	/* The interrupts */
	uart0 {
		compatible = "mstar8250-uart";
		interrupt-parent = <&mtk_intc0>;
		interrupts = <0x0 0x0 0x4>;
	};

	pm_sleep_int {
		compatible = "pm_sleep_int";
		interrupt-parent = <&mtk_intc0>;
		interrupts = <0x0 0x1 0x4>;
	};

	irq_vd_evd_r22hi {
		compatible = "irq_vd_evd_r22hi";
		interrupt-parent = <&mtk_intc0>;
		interrupts = <0x0 0x2 0x4>;
	};

	mvd_int {
		compatible = "mvd_int";
		interrupt-parent = <&mtk_intc0>;
		interrupts = <0x0 0x3 0x4>;
	};

	ps_int {
		compatible = "ps_int";
		interrupt-parent = <&mtk_intc0>;
		interrupts = <0x0 0x4 0x4>;
	};

	mmc0: mstar_mci {
		compatible = "mstar_mci";
		cap-mmc-highspeed;
		mmc-ddr-1_8v;
		mmc-hs200-1_8v;
		mmc-hs400-1_8v;
		mmc-hs400-enhanced-strobe;
		status ="okay";
		bus-width = <8>;
		non-removable;
		max-frequency = <200000000>;
		emmc-custom-dev-driving = <2>;
		interrupt-parent = <&mtk_intc0>;
		interrupts = <0x0 0x5 0x4>;
	};

	usb_int {
		compatible = "usb_int";
		interrupt-parent = <&mtk_intc0>;
		interrupts = <0x0 0x6 0x4>;
	};

	uhc_int {
		compatible = "uhc_int";
		interrupt-parent = <&mtk_intc0>;
		interrupts = <0x0 0x7 0x4>;
	};

	lpll_intr {
		compatible = "lpll_intr";
		interrupt-parent = <&mtk_intc0>;
		interrupts = <0x0 0x8 0x4>;
	};

	emac_int {
		compatible = "emac_int";
		interrupt-parent = <&mtk_intc0>;
		interrupts = <0x0 0x9 0x4>;
	};

	disp_be_int {
		compatible = "disp_be_int";
		interrupt-parent = <&mtk_intc0>;
		interrupts = <0x0 0xa 0x4>;
	};

	mspi_int {
		compatible = "mspi_int";
		interrupt-parent = <&mtk_intc0>;
		interrupts = <0x0 0xb 0x4>;
	};

	ge_int {
		compatible = "ge_int";
		interrupt-parent = <&mtk_intc0>;
		interrupts = <0x0 0xc 0x4>;
	};

	evd_int {
		compatible = "evd_int";
		interrupt-parent = <&mtk_intc0>;
		interrupts = <0x0 0xd 0x4>;
	};

	comb_int {
		compatible = "comb_int";
		interrupt-parent = <&mtk_intc0>;
		interrupts = <0x0 0xe 0x4>;
	};

	mod_detect_intr {
		compatible = "mod_detect_intr";
		interrupt-parent = <&mtk_intc0>;
		interrupts = <0x0 0xf 0x4>;
	};

	tsp2hk_int {
		compatible = "tsp2hk_int";
		interrupt-parent = <&mtk_intc0>;
		interrupts = <0x0 0x10 0x4>;
	};

	cec_int_pm {
		compatible = "cec_int_pm";
		interrupt-parent = <&mtk_intc0>;
		interrupts = <0x0 0x11 0x4>;
	};

	disp_fe_int {
		compatible = "disp_fe_int";
		interrupt-parent = <&mtk_intc0>;
		interrupts = <0x0 0x12 0x4>;
	};

	dc_int {
		compatible = "dc_int";
		interrupt-parent = <&mtk_intc0>;
		interrupts = <0x0 0x13 0x4>;
	};

	gop_int {
		compatible = "gop_int";
		interrupt-parent = <&mtk_intc0>;
		interrupts = <0x0 0x14 0x4>;
	};

	scdc_int_pm {
		compatible = "scdc_int_pm";
		interrupt-parent = <&mtk_intc0>;
		interrupts = <0x0 0x15 0x4>;
	};

	otg_int {
		compatible = "otg_int";
		interrupt-parent = <&mtk_intc0>;
		interrupts = <0x0 0x16 0x4>;
	};

	d2b_int {
		compatible = "d2b_int";
		interrupt-parent = <&mtk_intc0>;
		interrupts = <0x0 0x17 0x4>;
	};

	AUDMA_V2_INTR {
		compatible = "AUDMA_V2_INTR";
		interrupt-parent = <&mtk_intc0>;
		interrupts = <0x0 0x18 0x4>;
	};
/*
	1'b0 {
		compatible = "1'b0";
		interrupts = <0x0 0x19 0x4>;
	};
*/
	emmc_osp_int {
		compatible = "emmc_osp_int";
		interrupt-parent = <&mtk_intc0>;
		interrupts = <0x0 0x1a 0x4>;
	};

	scm_int {
		compatible = "scm_int";
		interrupt-parent = <&mtk_intc0>;
		interrupts = <0x0 0x1b 0x4>;
	};

	vbi_int {
		compatible = "vbi_int";
		interrupt-parent = <&mtk_intc0>;
		interrupts = <0x0 0x1c 0x4>;
	};

	mvd2mips_int {
		compatible = "mvd2mips_int";
		interrupt-parent = <&mtk_intc0>;
		interrupts = <0x0 0x1d 0x4>;
	};

	gpd_int {
		compatible = "gpd_int";
		interrupt-parent = <&mtk_intc0>;
		interrupts = <0x0 0x1e 0x4>;
	};

	tso_int {
		compatible = "tso_int";
		interrupt-parent = <&mtk_intc0>;
		interrupts = <0x0 0x1f 0x4>;
	};

	hvd_int {
		compatible = "hvd_int";
		interrupt-parent = <&mtk_intc0>;
		interrupts = <0x0 0x20 0x4>;
	};

	usb_int1 {
		compatible = "usb_int1";
		interrupt-parent = <&mtk_intc0>;
		interrupts = <0x0 0x21 0x4>;
	};

	miu_int {
		compatible = "miu_int";
		interrupt-parent = <&mtk_intc0>;
		interrupts = <0x0 0x22 0x4>;
	};

	error_resp_int {
		compatible = "error_resp_int";
		interrupt-parent = <&mtk_intc0>;
		interrupts = <0x0 0x23 0x4>;
	};

	usb_int2 {
		compatible = "usb_int2";
		interrupt-parent = <&mtk_intc0>;
		interrupts = <0x0 0x24 0x4>;
	};

	rtc2_int {
		compatible = "rtc2_int";
		interrupt-parent = <&mtk_intc0>;
		interrupts = <0x0 0x25 0x4>;
	};

	aesdma_s_int {
		compatible = "aesdma_s_int";
		interrupt-parent = <&mtk_intc0>;
		interrupts = <0x0 0x26 0x4>;
	};

	int_uart1 {
		compatible = "int_uart1";
		interrupt-parent = <&mtk_intc0>;
		interrupts = <0x0 0x27 0x4>;
	};

	disp_mfdec_int {
		compatible = "disp_mfdec_int";
		interrupt-parent = <&mtk_intc0>;
		interrupts = <0x0 0x28 0x4>;
	};

	mspi_cilink_int {
		compatible = "mspi_cilink_int";
		interrupt-parent = <&mtk_intc0>;
		interrupts = <0x0 0x29 0x4>;
	};

	miu_security_int {
		compatible = "miu_security_int";
		interrupt-parent = <&mtk_intc0>;
		interrupts = <0x0 0x2a 0x4>;
	};

	dipw_INT {
		compatible = "dipw_INT";
		interrupt-parent = <&mtk_intc0>;
		interrupts = <0x0 0x2b 0x4>;
	};

	miic2_int {
		compatible = "miic2_int";
		interrupt-parent = <&mtk_intc0>;
		interrupts = <0x0 0x2c 0x4>;
	};

	jpd_int {
		compatible = "jpd_int";
		interrupt-parent = <&mtk_intc0>;
		interrupts = <0x0 0x2d 0x4>;
	};

	pm_irq_out {
		compatible = "pm_irq_out";
		interrupt-parent = <&mtk_intc0>;
		interrupts = <0x0 0x2e 0x4>;
	};

	pka_all_int {
		compatible = "pka_all_int";
		interrupt-parent = <&mtk_intc0>;
		interrupts = <0x0 0x2f 0x4>;
	};

	int_bdma_merge {
		compatible = "int_bdma_merge";
		interrupt-parent = <&mtk_intc0>;
		interrupts = <0x0 0x30 0x4>;
	};

	PAS_PTS_INTRL_COMBINE {
		compatible = "PAS_PTS_INTRL_COMBINE";
		interrupt-parent = <&mtk_intc0>;
		interrupts = <0x0 0x31 0x4>;
	};

	uart2mcu_intr {
		compatible = "uart2mcu_intr";
		interrupt-parent = <&mtk_intc0>;
		interrupts = <0x0 0x32 0x4>;
	};

	urdma2mcu_intr {
		compatible = "urdma2mcu_intr";
		interrupt-parent = <&mtk_intc0>;
		interrupts = <0x0 0x33 0x4>;
	};

	dvi_hdmi_hdcp_int {
		compatible = "dvi_hdmi_hdcp_int";
		interrupt-parent = <&mtk_intc0>;
		interrupts = <0x0 0x34 0x4>;
	};

	g3d2mcu_irq_dft {
		compatible = "g3d2mcu_irq_dft";
		interrupt-parent = <&mtk_intc0>;
		interrupts = <0x0 0x35 0x4>;
	};

	fcie_tee_int {
		compatible = "fcie_tee_int";
		interrupt-parent = <&mtk_intc0>;
		interrupts = <0x0 0x36 0x4>;
	};

	smart_int {
		compatible = "smart_int";
		interrupt-parent = <&mtk_intc0>;
		interrupts = <0x0 0x37 0x4>;
	};

	hdcp_x74_int {
		compatible = "hdcp_x74_int";
		interrupt-parent = <&mtk_intc0>;
		interrupts = <0x0 0x38 0x4>;
	};

	wadr_err_int {
		compatible = "wadr_err_int";
		interrupt-parent = <&mtk_intc0>;
		interrupts = <0x0 0x39 0x4>;
	};

	ve_int {
		compatible = "ve_int";
		interrupt-parent = <&mtk_intc0>;
		interrupts = <0x0 0x3a 0x4>;
	};

	sdio_int {
		compatible = "sdio_int";
		interrupt-parent = <&mtk_intc0>;
		interrupts = <0x0 0x3b 0x4>;
	};

	acpu_int {
		compatible = "acpu_int";
		interrupt-parent = <&mtk_intc0>;
		interrupts = <0x0 0x3c 0x4>;
	};

	miic1_int {
		compatible = "miic1_int";
		interrupt-parent = <&mtk_intc0>;
		interrupts = <0x0 0x3d 0x4>;
	};

	usb_int3 {
		compatible = "usb_int3";
		interrupt-parent = <&mtk_intc0>;
		interrupts = <0x0 0x3e 0x4>;
	};

	miic0_int {
		compatible = "miic0_int";
		interrupt-parent = <&mtk_intc0>;
		interrupts = <0x0 0x3f 0x4>;
	};

	int_timer0 {
		compatible = "int_timer0";
		interrupt-parent = <&mtk_intc1>;
		interrupts = <0x0 0x0 0x4>;
	};

	int_timer1 {
		compatible = "int_timer1";
		interrupt-parent = <&mtk_intc1>;
		interrupts = <0x0 0x1 0x4>;
	};

	int_wdt {
		compatible = "int_wdt";
		interrupt-parent = <&mtk_intc1>;
		interrupts = <0x0 0x2 0x4>;
	};

	usb_int_merge3 {
		compatible = "usb_int_merge3";
		interrupt-parent = <&mtk_intc1>;
		interrupts = <0x0 0x3 0x4>;
	};

	AU_SPDIF_TX_CS_INT0 {
		compatible = "AU_SPDIF_TX_CS_INT0";
		interrupt-parent = <&mtk_intc1>;
		interrupts = <0x0 0x4 0x4>;
	};

	AU_SPDIF_TX_CS_INT1 {
		compatible = "AU_SPDIF_TX_CS_INT1";
		interrupt-parent = <&mtk_intc1>;
		interrupts = <0x0 0x5 0x4>;
	};

	MB_DSP2toMCU_INT0 {
		compatible = "MB_DSP2toMCU_INT0";
		interrupt-parent = <&mtk_intc1>;
		interrupts = <0x0 0x6 0x4>;
	};

	MB_DSP2toMCU_INT1 {
		compatible = "MB_DSP2toMCU_INT1";
		interrupt-parent = <&mtk_intc1>;
		interrupts = <0x0 0x7 0x4>;
	};

	usb_int_fiq {
		compatible = "usb_int_fiq";
		interrupt-parent = <&mtk_intc1>;
		interrupts = <0x0 0x8 0x4>;
	};

	uhc_int_fiq {
		compatible = "uhc_int_fiq";
		interrupt-parent = <&mtk_intc1>;
		interrupts = <0x0 0x9 0x4>;
	};

	ve_done_TT_irq {
		compatible = "ve_done_TT_irq";
		interrupt-parent = <&mtk_intc1>;
		interrupts = <0x0 0xa 0x4>;
	};

	HDMI_NON_PCM_MODE_INT_OUT {
		compatible = "HDMI_NON_PCM_MODE_INT_OUT";
		interrupt-parent = <&mtk_intc1>;
		interrupts = <0x0 0xb 0x4>;
	};

	SPDIF_IN_NON_PCM_INT_OUT {
		compatible = "SPDIF_IN_NON_PCM_INT_OUT";
		interrupt-parent = <&mtk_intc1>;
		interrupts = <0x0 0xc 0x4>;
	};

	lan_esd_int {
		compatible = "lan_esd_int";
		interrupt-parent = <&mtk_intc1>;
		interrupts = <0x0 0xd 0x4>;
	};

	SE_DSP2UP_intr {
		compatible = "SE_DSP2UP_intr";
		interrupt-parent = <&mtk_intc1>;
		interrupts = <0x0 0xe 0x4>;
	};

	tsp2aeon_int {
		compatible = "tsp2aeon_int";
		interrupt-parent = <&mtk_intc1>;
		interrupts = <0x0 0xf 0x4>;
	};

	vivaldi_str_intr {
		compatible = "vivaldi_str_intr";
		interrupt-parent = <&mtk_intc1>;
		interrupts = <0x0 0x10 0x4>;
	};

	vivaldi_pts_intr {
		compatible = "vivaldi_pts_intr";
		interrupt-parent = <&mtk_intc1>;
		interrupts = <0x0 0x11 0x4>;
	};

	DSP_MIU_PROT_intr {
		compatible = "DSP_MIU_PROT_intr";
		interrupt-parent = <&mtk_intc1>;
		interrupts = <0x0 0x12 0x4>;
	};

	xiu_timeout_int {
		compatible = "xiu_timeout_int";
		interrupt-parent = <&mtk_intc1>;
		interrupts = <0x0 0x13 0x4>;
	};

	dmdmcu2hk_int {
		compatible = "dmdmcu2hk_int";
		interrupt-parent = <&mtk_intc1>;
		interrupts = <0x0 0x14 0x4>;
	};

	ir_in {
		compatible = "ir_in";
		interrupt-parent = <&mtk_intc1>;
		interrupts = <0x0 0x15 0x4>;
	};

	imi_top_irq {
		compatible = "imi_top_irq";
		interrupt-parent = <&mtk_intc1>;
		interrupts = <0x0 0x16 0x4>;
	};

	vdmcu2hk_int {
		compatible = "vdmcu2hk_int";
		interrupt-parent = <&mtk_intc1>;
		interrupts = <0x0 0x17 0x4>;
	};

	ldm_dma_done_int0 {
		compatible = "ldm_dma_done_int0";
		interrupt-parent = <&mtk_intc1>;
		interrupts = <0x0 0x18 0x4>;
	};

	ldm_dma_done_int1 {
		compatible = "ldm_dma_done_int1";
		interrupt-parent = <&mtk_intc1>;
		interrupts = <0x0 0x19 0x4>;
	};

	PM_SD_CDZ_int {
		compatible = "PM_SD_CDZ_int";
		interrupt-parent = <&mtk_intc1>;
		interrupts = <0x0 0x1a 0x4>;
	};

	MB_auR2toMCU_INT0 {
		compatible = "MB_auR2toMCU_INT0";
		interrupt-parent = <&mtk_intc1>;
		interrupts = <0x0 0x1b 0x4>;
	};

	AFEC_VSYNC {
		compatible = "AFEC_VSYNC";
		interrupt-parent = <&mtk_intc1>;
		interrupts = <0x0 0x1c 0x4>;
	};

	MB_auR2toMCU_INT1 {
		compatible = "MB_auR2toMCU_INT1";
		interrupt-parent = <&mtk_intc1>;
		interrupts = <0x0 0x1d 0x4>;
	};

	MB_auR2toMCU_INT2 {
		compatible = "MB_auR2toMCU_INT2";
		interrupt-parent = <&mtk_intc1>;
		interrupts = <0x0 0x1e 0x4>;
	};

	DSP2MIPS_INT {
		compatible = "DSP2MIPS_INT";
		interrupt-parent = <&mtk_intc1>;
		interrupts = <0x0 0x1f 0x4>;
	};

	MB_auR2toMCU_INT3 {
		compatible = "MB_auR2toMCU_INT3";
		interrupt-parent = <&mtk_intc1>;
		interrupts = <0x0 0x20 0x4>;
	};

	AU_DMA_BUFFER_INT_EDGE {
		compatible = "AU_DMA_BUFFER_INT_EDGE";
		interrupt-parent = <&mtk_intc1>;
		interrupts = <0x0 0x21 0x4>;
	};

	int_all {
		compatible = "int_all";
		interrupt-parent = <&mtk_intc1>;
		interrupts = <0x0 0x22 0x4>;
	};

	PM_SD_CDZ1_int {
		compatible = "PM_SD_CDZ1_int";
		interrupt-parent = <&mtk_intc1>;
		interrupts = <0x0 0x23 0x4>;
	};

	reg_hst0to3_int {
		compatible = "reg_hst0to3_int";
		interrupt-parent = <&mtk_intc1>;
		interrupts = <0x0 0x24 0x4>;
	};

	reg_hst0to2_int {
		compatible = "reg_hst0to2_int";
		interrupt-parent = <&mtk_intc1>;
		interrupts = <0x0 0x25 0x4>;
	};

	reg_hst0to1_int {
		compatible = "reg_hst0to1_int";
		interrupt-parent = <&mtk_intc1>;
		interrupts = <0x0 0x26 0x4>;
	};

	ext_gpio_int0 {
		compatible = "ext_gpio_int0";
		interrupt-parent = <&mtk_intc1>;
		interrupts = <0x0 0x27 0x4>;
	};

	reg_hst1to3_int {
		compatible = "reg_hst1to3_int";
		interrupt-parent = <&mtk_intc1>;
		interrupts = <0x0 0x28 0x4>;
	};

	emac_man_int {
		compatible = "emac_man_int";
		interrupt-parent = <&mtk_intc1>;
		interrupts = <0x0 0x29 0x4>;
	};

	reg_hst1to0_int {
		compatible = "reg_hst1to0_int";
		interrupt-parent = <&mtk_intc1>;
		interrupts = <0x0 0x2a 0x4>;
	};

	ext_gpio_int1 {
		compatible = "ext_gpio_int1";
		interrupt-parent = <&mtk_intc1>;
		interrupts = <0x0 0x2b 0x4>;
	};

	reg_hst2to3_int {
		compatible = "reg_hst2to3_int";
		interrupt-parent = <&mtk_intc1>;
		interrupts = <0x0 0x2c 0x4>;
	};

	int_timer2 {
		compatible = "int_timer2";
		interrupt-parent = <&mtk_intc1>;
		interrupts = <0x0 0x2d 0x4>;
	};

	reg_hst2to0_int {
		compatible = "reg_hst2to0_int";
		interrupt-parent = <&mtk_intc1>;
		interrupts = <0x0 0x2e 0x4>;
	};

	ext_gpio_int2 {
		compatible = "ext_gpio_int2";
		interrupt-parent = <&mtk_intc1>;
		interrupts = <0x0 0x2f 0x4>;
	};

	reg_hst3to2_int {
		compatible = "reg_hst3to2_int";
		interrupt-parent = <&mtk_intc1>;
		interrupts = <0x0 0x30 0x4>;
	};

	reg_hst3to1_int {
		compatible = "reg_hst3to1_int";
		interrupt-parent = <&mtk_intc1>;
		interrupts = <0x0 0x31 0x4>;
	};

	reg_hst3to0_int {
		compatible = "reg_hst3to0_int";
		interrupt-parent = <&mtk_intc1>;
		interrupts = <0x0 0x32 0x4>;
	};

	usb_int_merge1 {
		compatible = "usb_int_merge1";
		interrupt-parent = <&mtk_intc1>;
		interrupts = <0x0 0x33 0x4>;
	};

	ve_vbi_f0_int {
		compatible = "ve_vbi_f0_int";
		interrupt-parent = <&mtk_intc1>;
		interrupts = <0x0 0x34 0x4>;
	};

	usb_int_merge2 {
		compatible = "usb_int_merge2";
		interrupt-parent = <&mtk_intc1>;
		interrupts = <0x0 0x35 0x4>;
	};

	ve_vbi_f1_int {
		compatible = "ve_vbi_f1_int";
		interrupt-parent = <&mtk_intc1>;
		interrupts = <0x0 0x36 0x4>;
	};

	ext_gpio_int3 {
		compatible = "ext_gpio_int3";
		interrupt-parent = <&mtk_intc1>;
		interrupts = <0x0 0x37 0x4>;
	};

	ext_gpio_int4 {
		compatible = "ext_gpio_int4";
		interrupt-parent = <&mtk_intc1>;
		interrupts = <0x0 0x38 0x4>;
	};

	ext_gpio_int5 {
		compatible = "ext_gpio_int5";
		interrupt-parent = <&mtk_intc1>;
		interrupts = <0x0 0x39 0x4>;
	};

	ext_gpio_int6 {
		compatible = "ext_gpio_int6";
		interrupt-parent = <&mtk_intc1>;
		interrupts = <0x0 0x3a 0x4>;
	};

	pwm_rp_l_int {
		compatible = "pwm_rp_l_int";
		interrupt-parent = <&mtk_intc1>;
		interrupts = <0x0 0x3b 0x4>;
	};

	pwm_fp_l_int {
		compatible = "pwm_fp_l_int";
		interrupt-parent = <&mtk_intc1>;
		interrupts = <0x0 0x3c 0x4>;
	};

	pwm_rp_r_int {
		compatible = "pwm_rp_r_int";
		interrupt-parent = <&mtk_intc1>;
		interrupts = <0x0 0x3d 0x4>;
	};

	pwm_fp_r_int {
		compatible = "pwm_fp_r_int";
		interrupt-parent = <&mtk_intc1>;
		interrupts = <0x0 0x3e 0x4>;
	};

	ext_gpio_int7 {
		compatible = "ext_gpio_int7";
		interrupt-parent = <&mtk_intc1>;
		interrupts = <0x0 0x3f 0x4>;
	};

	miic3_int {
		compatible = "miic3_int";
		interrupt-parent = <&mtk_intc2>;
		interrupts = <0x0 0x0 0x4>;
	};

/*
	1'b0 {
		compatible = "1'b0";
		interrupts = <0x0 129 0x4>;
	};

	1'b0 {
		compatible = "1'b0";
		interrupts = <0x0 130 0x4>;
	};
*/

	int_uart2 {
		compatible = "int_uart2";
		interrupt-parent = <&mtk_intc2>;
		interrupts = <0x0 0x3 0x4>;
	};

/*
	1'b0 {
		compatible = "1'b0";
		interrupts = <0x0 132 0x4>;
	};

	1'b0 {
		compatible = "1'b0";
		interrupts = <0x0 133 0x4>;
	};
*/

	mfe_int {
		compatible = "mfe_int";
		interrupt-parent = <&mtk_intc2>;
		interrupts = <0x0 0x6 0x4>;
	};

	cmdq_int {
		compatible = "cmdq_int";
		interrupt-parent = <&mtk_intc2>;
		interrupts = <0x0 0x7 0x4>;
	};

	pcm2mcu_int {
		compatible = "pcm2mcu_int";
		interrupt-parent = <&mtk_intc2>;
		interrupts = <0x0 0x8 0x4>;
	};

	sc_hk_int {
		compatible = "sc_hk_int";
		interrupt-parent = <&mtk_intc2>;
		interrupts = <0x0 0x9 0x4>;
	};

/*
	1'b0 {
		compatible = "1'b0";
		interrupts = <0x0 138 0x4>;
	};
*/

	ci_gpio_int {
		compatible = "ci_gpio_int";
		interrupt-parent = <&mtk_intc2>;
		interrupts = <0x0 0xb 0x4>;
	};

	cilink_soc_if {
		compatible = "cilink_soc_if";
		interrupt-parent = <&mtk_intc2>;
		interrupts = <0x0 0xc 0x4>;
	};

	tsp_fi_queue_int {
		compatible = "tsp_fi_queue_int";
		interrupt-parent = <&mtk_intc2>;
		interrupts = <0x0 0xd 0x4>;
	};

	tsen_0_ov_irq {
		compatible = "tsen_0_ov_irq";
		interrupt-parent = <&mtk_intc2>;
		interrupts = <0x0 0xe 0x4>;
	};

	tsen_1_ov_irq {
		compatible = "tsen_1_ov_irq";
		interrupt-parent = <&mtk_intc2>;
		interrupts = <0x0 0xf 0x4>;
	};

	frc_irq {
		compatible = "frc_irq";
		interrupt-parent = <&mtk_intc2>;
		interrupts = <0x0 0x10 0x4>;
	};

/*
	1'b0 {
		compatible = "1'b0";
		interrupts = <0x0 145 0x4>;
	};
*/

	lzma_irq {
		compatible = "lzma_irq";
		interrupt-parent = <&mtk_intc2>;
		interrupts = <0x0 0x12 0x4>;
	};

	paga_irq {
		compatible = "paga_irq";
		interrupt-parent = <&mtk_intc2>;
		interrupts = <0x0 0x13 0x4>;
	};

	adcpll_irq {
		compatible = "adcpll_irq";
		interrupt-parent = <&mtk_intc2>;
		interrupts = <0x0 0x14 0x4>;
	};

	timer {
		compatible = "arm,armv8-timer";
		interrupt-parent = <&gic>;
		interrupts = <1 13 0xff01>,
			     <1 14 0xff01>,
			     <1 11 0xff01>,
			     <1 10 0xff01>;
		clock-frequency = <12000000>;
	};

	pmu {
		compatible = "arm,armv8-pmuv3";
		interrupt-parent = <&gic>;
		interrupts = <0x0 0x86 0x4>,
			     <0x0 0x88 0x4>,
			     <0x0 0x8a 0x4>,
			     <0x0 0x8c 0x4>;
	};

	emac {
	        compatible = "mstar-emac";
	};

	miu {
		compatible = "mstar-miu";
	};

	ir {
	        compatible = "mstar-ir";
	};

	Mstar-ehci-1 {
		compatible = "Mstar-ehci-1";
	};

	Mstar-ehci-2 {
		compatible = "Mstar-ehci-2";
	};

	Mstar-ehci-3 {
		compatible = "Mstar-ehci-3";
	};

	Mstar-ehci-4 {
		compatible = "Mstar-ehci-4";
	};

	alsa {
		compatible = "Mstar-alsa";
	};

	mstar-rtc@0 {
		compatible = "mstar-rtc";
		index = <0>;
		xtal = <12000000>;
		freq = <1>;
	};

	mstar-pm {
		compatible = "mstar-pm";
	};

	mbx {
		compatible = "mstar-mbx";
	};

	mvd {
		compatible = "mvd";
	};

	ps {
		compatible = "Mstar-mvd";
	};

	Mstar-usb {
		compatible = "Mstar-usb";
	};

	scaler {
		compatible = "mstar-scaler";
	};

	mstar-tsp {
		compatible = "Mstar-tsp";
	};

	gflip {
		compatible = "mstar-gflip";
	};

	hdmitx4vx1 {
		compatible = "mstar-hdmitx4vx1";
	};

	xc {
		compatible = "mstar-xc";
	};

	bdma_merge {
		compatible = "Mstar-dipw";
	};

	Mstar-udc {
		compatible = "Mstar-udc";
	};

	Mstar-otg {
		compatible = "Mstar-otg";
	};

        buf_tag {
        /* heaptype: HEAP_TYPE_IOMMU = 0, HEAP_TYPE_CMA= 1,  HEAP_TYPE_NON_MMA = 2*/
        /* miutype:  UMA_OR_MIU0 = 0, MIU_1 = 1 */
                inject_filein {
                        heaptype = <0>;
                        max_size = <0x0 0x0200000>;
                        miu = <0>;
                        mmap_name = "MI_INJECT_BUF";
                };
                inject_secure {
                        heaptype = <0>;
                        max_size = <0x0 0x0200000>;
                        miu = <0>;
                        mmap_name = "E_MMAP_ID_OPTEE_MEM_EXT";
                };
        };
};

